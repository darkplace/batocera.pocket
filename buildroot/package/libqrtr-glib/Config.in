## package/batocera/emulators/xenia-canary/Config.in
```kconfig
config BR2_PACKAGE_XENIA_CANARY
	bool "xenia-canary"
	depends on BR2_x86_64 || BR2_aarch64
	select BR2_PACKAGE_ALSA_LIB
	select BR2_PACKAGE_FONTCONFIG
	select BR2_PACKAGE_LIBGTK3
	select BR2_PACKAGE_LIBGTK3_X11
	select BR2_PACKAGE_LZ4
	select BR2_PACKAGE_SDL2
	select BR2_PACKAGE_VULKAN_HEADERS
	select BR2_PACKAGE_VULKAN_LOADER
	select BR2_PACKAGE_WINE_PROTON if BR2_x86_64
	select BR2_PACKAGE_XLIB_LIBX11
	select BR2_PACKAGE_LIBXCB
	select BR2_PACKAGE_PYTHON_TOML
	help
	  Xenia is an open source research project for emulating Xbox 360
	  games on modern PCs. This is the bleeding edge canary release,
	  built natively for Vulkan while keeping the Windows build for D3D12/Wine.

	  https://xenia.jp/
```

## package/batocera/emulators/yuzu/Config.in
```kconfig
config BR2_PACKAGE_YUZU
	bool "Yuzu (Nintendo Switch)"
	depends on BR2_x86_64 || BR2_aarch64
	select BR2_PACKAGE_BOOST
	select BR2_PACKAGE_BOOST_CONTEXT
	select BR2_PACKAGE_BOOST_FILESYSTEM
	select BR2_PACKAGE_BOOST_SYSTEM
	select BR2_PACKAGE_ENET
	select BR2_PACKAGE_FFMPEG
	select BR2_PACKAGE_FMT
	select BR2_PACKAGE_JSON_FOR_MODERN_CPP
	select BR2_PACKAGE_LIBOPENSSL
	select BR2_PACKAGE_LZ4
	select BR2_PACKAGE_OPUS
	select BR2_PACKAGE_QT6
	select BR2_PACKAGE_QT6BASE
	select BR2_PACKAGE_QT6BASE_CONCURRENT
	select BR2_PACKAGE_QT6BASE_DBUS
	select BR2_PACKAGE_QT6BASE_GUI
	select BR2_PACKAGE_QT6BASE_NETWORK
	select BR2_PACKAGE_QT6BASE_VULKAN
	select BR2_PACKAGE_QT6BASE_WIDGETS
	select BR2_PACKAGE_QT6BASE_XCB if BR2_PACKAGE_XORG7
	select BR2_PACKAGE_SDL2
	select BR2_PACKAGE_VULKAN_HEADERS
	select BR2_PACKAGE_VULKAN_LOADER
	select BR2_PACKAGE_ZLIB
	select BR2_PACKAGE_ZSTD
	help
	  Yuzu Nintendo Switch emulator.

	  This package builds Yuzu from source and installs the native Qt
	  frontend behind the wrapper script in /usr/bin/yuzu.
```

## package/batocera/gpu/mesa3d-turnip-gamescope-sm8550/Config.in
```kconfig
config BR2_PACKAGE_MESA3D_TURNIP_GAMESCOPE_SM8550
	bool "mesa3d-turnip-gamescope-sm8550"
	depends on BR2_PACKAGE_BATOCERA_TARGET_SM8550
	depends on BR2_PACKAGE_MESA3D
	depends on BR2_PACKAGE_MESA3D_VULKAN_DRIVER_FREEDRENO
	help
	  Build a second Freedreno Turnip Vulkan ICD for sm8550 Steam
	  gamescope sessions. This driver carries a queue-submit workaround
	  that fixes gamescope on some sm8550 devices, while the normal Mesa
	  ICD remains the default for emulators and games.
```

## package/batocera/gpu/vulkan/vulkan-validationlayers/Config.in
```kconfig
config BR2_PACKAGE_VULKAN_VALIDATIONLAYERS
    bool "vulkan-validationlayers"
    depends on BR2_INSTALL_LIBSTDCPP
    depends on !BR2_STATIC_LIBS
    depends on BR2_TOOLCHAIN_GCC_AT_LEAST_8 # spirv-tools
    select BR2_PACKAGE_SPIRV_TOOLS
    select BR2_PACKAGE_VULKAN_HEADERS
    select BR2_PACKAGE_VULKAN_UTILITY_LIBRARIES
    help
      Vulkan Validation Layers (VVL)
      
      https://github.com/KhronosGroup/Vulkan-ValidationLayers
```

## package/batocera/libraries/libchdr/Config.in
```kconfig
config BR2_PACKAGE_LIBCHDR
	bool "libchdr"
	help
	  CHD decompression library used by emulators.

	  https://github.com/devmiyax/libchdr
```
