## buildroot/package/libqrtr-glib/Config.in
```kconfig
config BR2_PACKAGE_LIBQRTR_GLIB
	bool "libqrtr-glib"
	depends on BR2_USE_WCHAR # glib2
	depends on BR2_TOOLCHAIN_HAS_THREADS # glib2
	depends on BR2_USE_MMU # glib2
	depends on BR2_TOOLCHAIN_HEADERS_AT_LEAST_4_15 # da7653f0faab
	select BR2_PACKAGE_LIBGLIB2
	help
	  Qualcomm IPC Router protocol helper library.
	  Optional dependency for libqmi >= 1.28.0.

	  https://www.freedesktop.org/software/libqmi/libqrtr-glib/latest/

if BR2_PACKAGE_LIBQRTR_GLIB

config BR2_PACKAGE_LIBQRTR_GLIB_INTROSPECTION
	bool "GObject introspection data"
	depends on BR2_PACKAGE_GOBJECT_INTROSPECTION
	default y
	help
	  Build and install GObject introspection metadata for libqrtr-glib.

endif

comment "libqrtr-glib needs a toolchain w/ wchar, threads, headers >= 4.15"
	depends on BR2_USE_MMU
	depends on !BR2_USE_WCHAR || !BR2_TOOLCHAIN_HAS_THREADS || \
		!BR2_TOOLCHAIN_HEADERS_AT_LEAST_4_15
```

## configs/batocera-rk3326_defconfig
```kconfig
# from file batocera-board.local.common

# from file batocera-board.common

# users
BR2_ROOTFS_USERS_TABLES="$(BR2_EXTERNAL_BATOCERA_PATH)/board/batocera/users.txt"

# toolchain definition
BR2_OPTIMIZE_2=y
BR2_ENABLE_LTO=y
BR2_SHARED_STATIC_LIBS=y
BR2_GCC_ENABLE_GRAPHITE=y
BR2_TOOLCHAIN_BUILDROOT_GLIBC=y
BR2_TOOLCHAIN_BUILDROOT_CXX=y
# required for utf-8
BR2_TOOLCHAIN_GLIBC_GCONV_LIBS_COPY=y
BR2_STRIP_EXCLUDE_DIRS="usr/bin/vpinball usr/share/ecwolf usr/bin/vita3k usr/bin/dmdserver"

# Allow to build GOLD linker, but do not use as default
BR2_BINUTILS_EXTRA_CONFIG_OPTIONS="--enable-gold --enable-plugins"

# prefer linux tools over busybox tools
BR2_PACKAGE_BUSYBOX=n
BR2_PACKAGE_BC=y
BR2_PACKAGE_COREUTILS=y
BR2_PACKAGE_DIFFUTILS=y
BR2_PACKAGE_DOS2UNIX=y
BR2_PACKAGE_FINDUTILS=y
BR2_PACKAGE_GAWK=y
BR2_PACKAGE_GREP=y
BR2_PACKAGE_GZIP=y
BR2_PACKAGE_IFUPDOWN=y
BR2_PACKAGE_IPUTILS=y
BR2_PACKAGE_KMOD=y
BR2_PACKAGE_KMOD_TOOLS=y
BR2_PACKAGE_LESS=y
BR2_PACKAGE_LSOF=y
BR2_PACKAGE_NCURSES=y
BR2_PACKAGE_NCURSES_TARGET_PROGS=y
BR2_PACKAGE_NETCAT=y
BR2_PACKAGE_NET_TOOLS=y
BR2_PACKAGE_NFS_UTILS=y
BR2_PACKAGE_NFS_UTILS_NFSV4=y
BR2_PACKAGE_PROCPS_NG=y
BR2_PACKAGE_PSMISC=y
BR2_PACKAGE_SED=y
BR2_PACKAGE_START_STOP_DAEMON=y
BR2_PACKAGE_SYSLOG_NG=y
BR2_PACKAGE_TAR=y
BR2_PACKAGE_TMUX=y
BR2_PACKAGE_UNRAR=y
BR2_PACKAGE_UTIL_LINUX_AGETTY=y
BR2_PACKAGE_UTIL_LINUX_BINARIES=y
BR2_PACKAGE_UTIL_LINUX_EJECT=y
BR2_PACKAGE_UTIL_LINUX_HWCLOCK=y
BR2_PACKAGE_UTIL_LINUX_KILL=y
BR2_PACKAGE_UTIL_LINUX_LOGGER=y
BR2_PACKAGE_UTIL_LINUX_LOGIN=y
BR2_PACKAGE_UTIL_LINUX_MORE=y
BR2_PACKAGE_UTIL_LINUX_MOUNT=y
BR2_PACKAGE_UTIL_LINUX_SU=y
BR2_PACKAGE_UTIL_LINUX_FALLOCATE=y
BR2_PACKAGE_WATCHDOG=y
BR2_PACKAGE_WHICH=y

# system
BR2_TARGET_GENERIC_HOSTNAME="batocera"
BR2_TARGET_GENERIC_ISSUE="READY TO RETRO"
BR2_INIT_SYSV=y
BR2_ROOTFS_DEVICE_CREATION_DYNAMIC_EUDEV=y
BR2_TARGET_GENERIC_ROOT_PASSWD="linux"
BR2_SYSTEM_ENABLE_NLS=y
BR2_ENABLE_LOCALE_WHITELIST="C ar ca cs_CZ cy cy_GB de en el es es_MX eu eu_ES fr fr_FR fi_FI gl_ES he hu id_ID it ja ja_JP ko nb nb_NO nl nn nn_NO oc oc_FR pl pt pt_PT pt_BR ru ru_RU uk uk_UA ro_RO sk_SK sv sv_SE tr vi_VN zh zh_CN zh_TW"
BR2_GENERATE_LOCALE="en_US.UTF-8 ar_YE.UTF-8 ca_ES.UTF-8 cs_CZ.UTF-8 cy_GB.UTF-8 de_DE.UTF-8 el_GR.UTF-8 en_GB.UTF-8 es_ES.UTF-8 es_MX.UTF-8 eu_ES.UTF-8 fr_FR.UTF-8 fi_FI.UTF-8 gl_ES.UTF-8 he_IL.UTF-8 hu_HU.UTF-8 id_ID.UTF-8 it_IT.UTF-8 ja_JP.UTF-8 ko_KR.UTF-8 nb_NO.UTF-8 nl_NL.UTF-8 nn_NO.UTF-8 oc_FR.UTF-8 pl_PL.UTF-8 pt_BR.UTF-8 pt_PT.UTF-8 ru_RU.UTF-8 uk_UA.UTF-8 ro_RO.UTF-8 sk_SK.UTF-8 sv_SE.UTF-8 tr_TR.UTF-8 vi_VN.UTF-8 zh_CN.UTF-8 zh_TW.UTF-8"
BR2_TARGET_TZ_INFO=y
BR2_TARGET_LOCALTIME="Europe/Paris"
# BR2_TARGET_GENERIC_REMOUNT_ROOTFS_RW is not set

# Initramfs decompression support
BR2_LINUX_KERNEL_LZ4=y

# Python choices
BR2_PACKAGE_PYTHON3_PY_PYC=y
BR2_PACKAGE_PYTHON_HASHLIB=y

BR2_PACKAGE_ESPEAK=y
BR2_PACKAGE_ESPEAK_AUDIO_BACKEND_ALSA=y
BR2_PACKAGE_GLIBC_UTILS=y

# disable the mosquitto broker which is on by default
BR2_PACKAGE_MOSQUITTO_BROKER=n

# dmd
BR2_PACKAGE_DMD_PLAY_RUST_DMD_PLAY_BIN=y

# System
BR2_PACKAGE_BATOCERA_SYSTEM=y
BR2_PACKAGE_BATOCERA_EXTRAS=y
BR2_PACKAGE_BATOCERA_TOOLS=y
BR2_PACKAGE_BATOCERA_ALL_SYSTEMS=y
BR2_PACKAGE_BATOCERA_LINUX_FIRMWARES=y
BR2_SYSTEM_BIN_SH_DASH=y # /bin/sh implementation; set here because a `choice` cannot be `select`ed, e.g. from batocera-system/Config.in
BR2_PACKAGE_DROPBEAR_LOCALOPTIONS_FILE="$(BR2_EXTERNAL_BATOCERA_PATH)/board/batocera/dropbear_localoptions.h"

# Disable generating rootfs tar (speedup)
BR2_TARGET_ROOTFS_TAR=n

# images
BR2_ROOTFS_POST_BUILD_SCRIPT="$(BR2_EXTERNAL_BATOCERA_PATH)/board/batocera/scripts/post-build-script.sh"
BR2_ROOTFS_POST_IMAGE_SCRIPT="$(BR2_EXTERNAL_BATOCERA_PATH)/board/batocera/scripts/post-image-script.sh"

# Batocera
#BR2_PACKAGE_BATOCERA_DEV=y
#BR2_PACKAGE_BATOCERA_DEBUG=y
#BR2_PACKAGE_BATOCERA_CORES_EXPERIMENTAL=y
BR2_PACKAGE_BATOCERA_VIDEO_CODECS=y

# Enables ccache
BR2_CCACHE=y

# Don't purge locales
BR2_ENABLE_LOCALE_PURGE=n

### from board file ###

# Target definition
BR2_aarch64=y
BR2_cortex_a35=y
BR2_ARM_FPU_NEON_FP_ARMV8=y
BR2_PACKAGE_BATOCERA_TARGET_RK3326=y
BR2_TARGET_OPTIMIZATION="-pipe -fsigned-char"
BR2_TARGET_GENERIC_GETTY_BAUDRATE_115200=y
BR2_GLOBAL_PATCH_DIR="$(BR2_EXTERNAL_BATOCERA_PATH)/board/batocera/patches $(BR2_EXTERNAL_BATOCERA_PATH)/board/batocera/rockchip/patches $(BR2_EXTERNAL_BATOCERA_PATH)/board/batocera/rockchip/rk3326/patches"
BR2_ROOTFS_OVERLAY="$(BR2_EXTERNAL_BATOCERA_PATH)/board/batocera/fsoverlay $(BR2_EXTERNAL_BATOCERA_PATH)/board/batocera/rockchip/fsoverlay $(BR2_EXTERNAL_BATOCERA_PATH)/board/batocera/rockchip/rk3326/fsoverlay"

# Kernel
BR2_LINUX_KERNEL=y
BR2_LINUX_KERNEL_CUSTOM_VERSION=y
BR2_LINUX_KERNEL_CUSTOM_VERSION_VALUE="6.18.3"
BR2_KERNEL_HEADERS_6_18=y
BR2_LINUX_KERNEL_PATCH="$(BR2_EXTERNAL_BATOCERA_PATH)/board/batocera/rockchip/rk3326/linux_patches"
BR2_LINUX_KERNEL_USE_CUSTOM_CONFIG=y
BR2_LINUX_KERNEL_CUSTOM_CONFIG_FILE="$(BR2_EXTERNAL_BATOCERA_PATH)/board/batocera/rockchip/rk3326/linux-defconfig.config"
BR2_LINUX_KERNEL_CONFIG_FRAGMENT_FILES="$(BR2_EXTERNAL_BATOCERA_PATH)/board/batocera/rockchip/rk3326/linux-defconfig-fragment.config"
BR2_LINUX_KERNEL_NEEDS_HOST_OPENSSL=y

# Build the DTB from the kernel sources
BR2_LINUX_KERNEL_DTS_SUPPORT=y
BR2_LINUX_KERNEL_INTREE_DTS_NAME="rockchip/rk3326-anbernic-rg351m rockchip/rk3326-anbernic-rg351v rockchip/rk3326-gameconsole-r33s rockchip/rk3326-gameconsole-r36s rockchip/rk3326-gameconsole-eeclone rockchip/rk3326-magicx-xu10 rockchip/rk3326-magicx-xu-mini-m rockchip/rk3326-odroid-go2 rockchip/rk3326-odroid-go2-v11 rockchip/rk3326-odroid-go3 rockchip/rk3326-powkiddy-rgb10 rockchip/rk3326-powkiddy-rgb10x rockchip/rk3326-powkiddy-rgb20s rockchip/rk3326-gameforce-chi"

# GPU
BR2_PACKAGE_BATOCERA_PANFROST_MESA3D=y
BR2_PACKAGE_BATOCERA_WAYLAND_LABWC=y

# Batocera splash screen
BR2_PACKAGE_BATOCERA_SPLASH_MPV=y

# Batocera system
BR2_PACKAGE_BATOCERA_KODI21=y

# Controller
BR2_PACKAGE_UINPUT_JOYSTICK=y

# Bootloader
BR2_PACKAGE_UBOOT_RK3326=y

# U-Boot dependency
BR2_TARGET_UBOOT_NEEDS_GNUTLS=y

# RK3326 Mainline U-Boot (Future)
#BR2_TARGET_UBOOT=y
#BR2_TARGET_UBOOT_BUILD_SYSTEM_KCONFIG=y
#BR2_TARGET_UBOOT_CUSTOM_VERSION=y
#BR2_TARGET_UBOOT_CUSTOM_GIT=y
#BR2_TARGET_UBOOT_CUSTOM_VERSION=y
#BR2_TARGET_UBOOT_CUSTOM_VERSION_VALUE="2025.10"
#BR2_TARGET_UBOOT_BOARD_DEFCONFIG="rk3326-handheld"
#BR2_TARGET_UBOOT_NEEDS_PYLIBFDT=y
#BR2_TARGET_UBOOT_NEEDS_OPENSSL=y
#BR2_TARGET_UBOOT_NEEDS_PYELFTOOLS=y
#BR2_TARGET_UBOOT_NEEDS_ROCKCHIP_RKBIN=y
#BR2_PACKAGE_HOST_DOSFSTOOLS=y
#BR2_PACKAGE_HOST_DTC=y
#BR2_PACKAGE_HOST_GENIMAGE=y
#BR2_PACKAGE_HOST_MTOOLS=y
#BR2_PACKAGE_HOST_UBOOT_TOOLS=y
#BR2_PACKAGE_ROCKCHIP_RKBIN=y
#BR2_PACKAGE_ROCKCHIP_RKBIN_TPL_FILENAME="bin/rk33/rk3326_ddr_333MHz_v2.11.bin"
#BR2_PACKAGE_ROCKCHIP_RKBIN_BL31_FILENAME="bin/rk33/rk3326_bl31_v1.34.elf"

# Firmware
BR2_PACKAGE_FIRMWARE_ESP8089=y
BR2_PACKAGE_ARMBIAN_FIRMWARE=y
BR2_PACKAGE_ARMBIAN_FIRMWARE_RTL8723BX=y
```
