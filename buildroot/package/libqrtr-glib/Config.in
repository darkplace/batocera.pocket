## configs/batocera-zen3_i386_libs_defconfig
```kconfig
# from file batocera-board.i386.libs
# SPDX-FileCopyrightText: Added/modified by suckbluefrog
# batocera-board.i386.libs
# Common configuration for 32-bit i386 library-only builds.

# users
BR2_ROOTFS_USERS_TABLES="$(BR2_EXTERNAL_BATOCERA_PATH)/board/batocera/users.txt"

# toolchain definition
BR2_OPTIMIZE_2=y
BR2_ENABLE_LTO=y
BR2_SHARED_STATIC_LIBS=y
BR2_GCC_ENABLE_GRAPHITE=y
BR2_TOOLCHAIN_BUILDROOT_GLIBC=y
BR2_TOOLCHAIN_BUILDROOT_CXX=y
BR2_TOOLCHAIN_GLIBC_GCONV_LIBS_COPY=y

# Allow to build GOLD linker, but do not use as default
BR2_BINUTILS_EXTRA_CONFIG_OPTIONS="--enable-gold --enable-plugins"

# Disable busybox - we only need libraries
BR2_PACKAGE_BUSYBOX=n

# system
BR2_TARGET_GENERIC_HOSTNAME="batocera"
BR2_TARGET_GENERIC_ISSUE="batocera-lib32-i386"
BR2_INIT_SYSV=y
BR2_ROOTFS_DEVICE_CREATION_DYNAMIC_EUDEV=y
BR2_TARGET_GENERIC_ROOT_PASSWD="linux"
BR2_SYSTEM_ENABLE_NLS=y
BR2_ENABLE_LOCALE_WHITELIST="C en"
BR2_GENERATE_LOCALE="en_US.UTF-8"
BR2_TARGET_TZ_INFO=y
BR2_TARGET_LOCALTIME="Europe/Paris"

# disable the mosquitto broker which is on by default
BR2_PACKAGE_MOSQUITTO_BROKER=n

# Disable full system packages - we only want libraries
BR2_PACKAGE_BATOCERA_SYSTEM=n
BR2_PACKAGE_BATOCERA_EXTRAS=n
BR2_PACKAGE_BATOCERA_TOOLS=n
BR2_PACKAGE_BATOCERA_ALL_SYSTEMS=n
BR2_PACKAGE_BATOCERA_LINUX_FIRMWARES=n
BR2_SYSTEM_BIN_SH_DASH=y

# Build tar file only - no image, no squashfs
BR2_TARGET_ROOTFS_TAR=y
BR2_TARGET_ROOTFS_TAR_NONE=y

# Enables ccache
BR2_CCACHE=y

# Don't purge locales
BR2_ENABLE_LOCALE_PURGE=n

# from file batocera-zen3_i386_libs.packages
# SPDX-FileCopyrightText: Added/modified by suckbluefrog
# batocera-zen3_i386_libs.packages
# Phase 5a: steam-core i386 runtime set (no Wine32 payload yet)

# Reuse the same dependency baseline as native x86_64 Steam.
BR2_PACKAGE_BATOCERA_STEAM_REQUIREMENTS=y

# 32-bit GL/Vulkan stack (priority for phase 5a)
BR2_PACKAGE_MESA3D_LLVM=y
BR2_PACKAGE_MESA3D_GALLIUM_DRIVER_I915=y
BR2_PACKAGE_MESA3D_GALLIUM_DRIVER_CROCUS=y
BR2_PACKAGE_MESA3D_GALLIUM_DRIVER_IRIS=y
BR2_PACKAGE_MESA3D_GALLIUM_DRIVER_NOUVEAU=y
BR2_PACKAGE_MESA3D_GALLIUM_DRIVER_R300=y
BR2_PACKAGE_MESA3D_GALLIUM_DRIVER_R600=y
BR2_PACKAGE_MESA3D_GALLIUM_DRIVER_RADEONSI=y
BR2_PACKAGE_MESA3D_GALLIUM_DRIVER_VIRGL=y
BR2_PACKAGE_MESA3D_GALLIUM_DRIVER_ZINK=y
BR2_PACKAGE_MESA3D_VULKAN_DRIVER_INTEL=y
BR2_PACKAGE_MESA3D_VULKAN_DRIVER_HASWELL=y
BR2_PACKAGE_MESA3D_VULKAN_DRIVER_AMD=y
BR2_PACKAGE_VULKAN_TOOLS=y

# Lutris native-title i386 baseline extras (beyond steam requirements)
BR2_PACKAGE_ALSA_LIB=y
BR2_PACKAGE_ALSA_LIB_DEVDIR="/dev/snd"
BR2_PACKAGE_ALSA_LIB_PCM_PLUGINS="all"
BR2_PACKAGE_ALSA_LIB_CTL_PLUGINS="all"
BR2_PACKAGE_ALSA_LIB_ALOAD=y
BR2_PACKAGE_ALSA_LIB_MIXER=y
BR2_PACKAGE_ALSA_LIB_PCM=y
BR2_PACKAGE_ALSA_LIB_RAWMIDI=y
BR2_PACKAGE_ALSA_LIB_HWDEP=y
BR2_PACKAGE_ALSA_LIB_SEQ=y
BR2_PACKAGE_ALSA_LIB_UCM=y
BR2_PACKAGE_ALSA_LIB_ALISP=y
BR2_PACKAGE_ALSA_LIB_OLD_SYMBOLS=y
BR2_PACKAGE_ALSA_LIB_TOPOLOGY=y
BR2_PACKAGE_ALSA_PLUGINS=y
BR2_PACKAGE_SDL=y
BR2_PACKAGE_SDL_X11=y
BR2_PACKAGE_SDL2=y
BR2_PACKAGE_SDL2_X11=y
BR2_PACKAGE_SDL2_OPENGL=y
BR2_PACKAGE_SDL2_IMAGE=y
BR2_PACKAGE_SDL2_MIXER=y
BR2_PACKAGE_SDL2_TTF=y
BR2_PACKAGE_OPENAL=y
BR2_PACKAGE_LIBTHEORA=y
BR2_PACKAGE_LIBVORBIS=y
BR2_PACKAGE_LIBOGG=y
BR2_PACKAGE_FREETYPE=y
BR2_PACKAGE_FONTCONFIG=y
BR2_PACKAGE_PULSEAUDIO_HAS_ATOMIC=y
BR2_PACKAGE_PULSEAUDIO_ENABLE_ATOMIC=y
BR2_PACKAGE_PULSEAUDIO=y
BR2_PACKAGE_OPENSSL_FORCE_LIBOPENSSL=y
BR2_PACKAGE_OPENSSL=y
BR2_PACKAGE_OPENSSL102_COMPAT=y
BR2_PACKAGE_LIBCURL=y
BR2_PACKAGE_LIBCURL_CURL=y
BR2_PACKAGE_LIBCURL_OPENSSL=y
BR2_PACKAGE_LIBPNG=y
BR2_PACKAGE_LIBPNG12_COMPAT=y
BR2_PACKAGE_WEBP=y
BR2_PACKAGE_WEBP_DEMUX=y
BR2_PACKAGE_WEBP_MUX=y
BR2_PACKAGE_FAUDIO=y
BR2_PACKAGE_UTIL_LINUX_LIBUUID=y
BR2_PACKAGE_EUDEV=y
BR2_PACKAGE_GCONF=y
BR2_PACKAGE_XLIB_LIBXEXT=y
BR2_PACKAGE_XLIB_LIBXINERAMA=y
BR2_PACKAGE_XLIB_LIBXRENDER=y
BR2_PACKAGE_XLIB_LIBXCOMPOSITE=y
BR2_PACKAGE_XLIB_LIBXXF86VM=y
BR2_PACKAGE_XLIB_LIBXCURSOR=y
BR2_PACKAGE_XLIB_LIBXI=y
BR2_PACKAGE_XLIB_LIBXRANDR=y
BR2_PACKAGE_XLIB_LIBX11=y
BR2_PACKAGE_LIBXCB=y
BR2_PACKAGE_LIBDRM=y
BR2_PACKAGE_VULKAN_LOADER=y
BR2_PACKAGE_IRRLICHT=y
BR2_PACKAGE_WINE_MONO
BR2_PACKAGE_MF
BR2_PACKAGE_RTKIT
BR2_PACKAGE_DXVK
BR2_PACKAGE_DXVK_NVAPI
# =============================================================================
# Audio - ALSA
# =============================================================================
BR2_PACKAGE_ALSA_LIB=y
BR2_PACKAGE_ALSA_LIB_DEVDIR="/dev/snd"
BR2_PACKAGE_ALSA_LIB_PCM_PLUGINS="all"
BR2_PACKAGE_ALSA_LIB_CTL_PLUGINS="all"
BR2_PACKAGE_ALSA_LIB_ALOAD=y
BR2_PACKAGE_ALSA_LIB_MIXER=y
BR2_PACKAGE_ALSA_LIB_PCM=y
BR2_PACKAGE_ALSA_LIB_RAWMIDI=y
BR2_PACKAGE_ALSA_LIB_HWDEP=y
BR2_PACKAGE_ALSA_LIB_SEQ=y
BR2_PACKAGE_ALSA_LIB_UCM=y
BR2_PACKAGE_ALSA_LIB_ALISP=y
BR2_PACKAGE_ALSA_LIB_OLD_SYMBOLS=y
BR2_PACKAGE_ALSA_LIB_TOPOLOGY=y
BR2_PACKAGE_ALSA_PLUGINS=y
BR2_PACKAGE_ALSA_UCM_CONF=y
BR2_PACKAGE_ALSA_UTILS=y
BR2_PACKAGE_ALSA_UTILS_ACONNECT=y
BR2_PACKAGE_ALSA_UTILS_ALSACTL=y
BR2_PACKAGE_ALSA_UTILS_ALSAMIXER=y
BR2_PACKAGE_ALSA_UTILS_ALSAUCM=y
BR2_PACKAGE_ALSA_UTILS_AMIXER=y
BR2_PACKAGE_ALSA_UTILS_APLAY=y
BR2_PACKAGE_ALSA_UTILS_APLAYMIDI=y
BR2_PACKAGE_ALSA_UTILS_ALSAINFO=y

# =============================================================================
# Audio - PulseAudio/PipeWire
# =============================================================================
BR2_PACKAGE_PULSEAUDIO_HAS_ATOMIC=y
BR2_PACKAGE_PULSEAUDIO_ENABLE_ATOMIC=y
BR2_PACKAGE_PULSEAUDIO=y
BR2_PACKAGE_PIPEWIRE=y
BR2_PACKAGE_PIPEWIRE_GSTREAMER=y
BR2_PACKAGE_PIPEWIRE_V4L2=y
BR2_PACKAGE_WIREPLUMBER=y

# =============================================================================
# Audio - Codecs and Libraries
# =============================================================================
BR2_PACKAGE_ESPEAK=y
BR2_PACKAGE_ESPEAK_AUDIO_BACKEND_ALSA=y
BR2_PACKAGE_FAAD2=y
BR2_PACKAGE_FDK_AAC=y
BR2_PACKAGE_FLAC=y
BR2_PACKAGE_FLUID_SOUNDFONT=y
BR2_PACKAGE_FLUIDSYNTH=y
BR2_PACKAGE_FLUIDSYNTH_ALSA_LIB=y
BR2_PACKAGE_FLUIDSYNTH_SDL2=y
BR2_PACKAGE_LAME=y
BR2_PACKAGE_LIBAO=y
BR2_PACKAGE_LIBMAD=y
BR2_PACKAGE_LIBMAD_OPTIMIZATION_DEFAULT=y
BR2_PACKAGE_LIBMAD_ASO=y
BR2_PACKAGE_LIBMODPLUG=y
BR2_PACKAGE_LIBSAMPLERATE=y
BR2_PACKAGE_LIBSNDFILE=y
BR2_PACKAGE_LIBVORBIS=y
BR2_PACKAGE_MPG123=y
BR2_PACKAGE_OPENAL=y
BR2_PACKAGE_OPUS=y
BR2_PACKAGE_OPUSFILE=y
BR2_PACKAGE_PORTAUDIO=y
BR2_PACKAGE_PORTAUDIO_ALSA=y
BR2_PACKAGE_PORTAUDIO_CXX=y
BR2_PACKAGE_SBC=y
BR2_PACKAGE_SPEEXDSP=y
BR2_PACKAGE_VO_AACENC=y
BR2_PACKAGE_LIBFREEAPTX=y
BR2_PACKAGE_LIBLDAC=y
BR2_PACKAGE_LIBLC3=y
BR2_PACKAGE_WILDMIDI=y
BR2_PACKAGE_ZMUSIC=y
BR2_PACKAGE_LIBXMP=y



# =============================================================================
# Graphics - Image Libraries
# =============================================================================
BR2_PACKAGE_CAIRO=y
BR2_PACKAGE_FONTCONFIG=y
BR2_PACKAGE_FREETYPE=y
BR2_PACKAGE_GIFLIB=y
BR2_PACKAGE_HARFBUZZ=y
BR2_PACKAGE_JPEG_SIMD_SUPPORT=y
BR2_PACKAGE_JPEG=y
BR2_PACKAGE_JPEG_TURBO=y
BR2_PACKAGE_LIBEPOXY=y
BR2_PACKAGE_LIBFREEIMAGE=y
BR2_PACKAGE_LIBPNG=y
BR2_PACKAGE_OPENJPEG=y
BR2_PACKAGE_PANGO=y
BR2_PACKAGE_PIXMAN=y
BR2_PACKAGE_POPPLER=y
BR2_PACKAGE_POPPLER_UTILS=y
BR2_PACKAGE_WEBP=y
BR2_PACKAGE_WEBP_DEMUX=y
BR2_PACKAGE_WEBP_MUX=y
BR2_PACKAGE_LIBGRAPHENE=y

# =============================================================================
# Graphics - OpenCV
# =============================================================================
BR2_PACKAGE_OPENCV4=y
BR2_PACKAGE_OPENCV4_LIB_IMGCODECS=y
BR2_PACKAGE_OPENCV4_LIB_IMGPROC=y
# Disable OpenCV Python bindings in i386 multilib to avoid selecting
# python-numpy, which fails on i386 long double ABI in numpy 1.25 meson checks.
# BR2_PACKAGE_OPENCV4_LIB_PYTHON is not set
BR2_PACKAGE_OPENCV4_LIB_VIDEOIO=y
BR2_PACKAGE_OPENCV4_LIB_VIDEO=y
BR2_PACKAGE_OPENCV4_WITH_FFMPEG=y
BR2_PACKAGE_OPENCV4_WITH_GSTREAMER1=y
BR2_PACKAGE_OPENCV4_JPEG2000_NONE=y
BR2_PACKAGE_OPENCV4_DISABLE_GAPI=y

# =============================================================================
# Graphics - Framebuffer
# =============================================================================
BR2_PACKAGE_FBV=y
BR2_PACKAGE_FBV_PNG=y
BR2_PACKAGE_FBV_JPEG=y

# =============================================================================
# SDL 1.2
# =============================================================================
BR2_PACKAGE_SDL=y
BR2_PACKAGE_SDL_FBCON=y
BR2_PACKAGE_SDL_GFX=y
BR2_PACKAGE_SDL_IMAGE=y
BR2_PACKAGE_SDL_IMAGE_BMP=y
BR2_PACKAGE_SDL_IMAGE_JPEG=y
BR2_PACKAGE_SDL_IMAGE_PNG=y
BR2_PACKAGE_SDL_SOUND=y
BR2_PACKAGE_SDL_TTF=y
BR2_PACKAGE_SDL12_COMPAT=y

# =============================================================================
# SDL 2
# =============================================================================
BR2_PACKAGE_SDL2=y
BR2_PACKAGE_SDL2_OPENGLES=y
BR2_PACKAGE_SDL2_KMSDRM=y
BR2_PACKAGE_SDL2_WAYLAND=y
BR2_PACKAGE_SDL2_GFX=y
BR2_PACKAGE_SDL2_IMAGE=y
BR2_PACKAGE_SDL2_MIXER=y
BR2_PACKAGE_SDL2_NET=y
BR2_PACKAGE_SDL2_TTF=y

# Wayland stack required by SDL2 wayland backend in 32-bit runtime.
BR2_PACKAGE_WAYLAND=y

# =============================================================================
# System - Core
# =============================================================================
BR2_PACKAGE_DBUS=y
BR2_PACKAGE_EUDEV=y
BR2_PACKAGE_EUDEV_MODULE_LOADING=y
BR2_PACKAGE_EUDEV_RULES_GEN=y
BR2_PACKAGE_EUDEV_ENABLE_HWDB=y
BR2_PACKAGE_EVTEST=y
BR2_PACKAGE_KBD=y
BR2_PACKAGE_TZDATA=y

# =============================================================================
# System - Crypto/Security
# =============================================================================
BR2_PACKAGE_CRYPTSETUP=y
BR2_PACKAGE_LUKSMETA=y
BR2_PACKAGE_CA_CERTIFICATES=y
BR2_PACKAGE_GNUTLS=y
BR2_PACKAGE_LIBARGON2=y
BR2_PACKAGE_LIBASSUAN=y
BR2_PACKAGE_LIBGPG_ERROR=y
BR2_PACKAGE_LIBGPGME=y
BR2_PACKAGE_LIBSODIUM=y
BR2_PACKAGE_LIBSODIUM_FULL=y
BR2_PACKAGE_LIBXCRYPT=y
BR2_PACKAGE_NETTLE=y
BR2_PACKAGE_OPENSSL_FORCE_LIBOPENSSL=y
BR2_PACKAGE_OPENSSL=y
BR2_PACKAGE_LIBOPENSSL=y
BR2_PACKAGE_LIBOPENSSL_BIN=y
BR2_PACKAGE_LIBOPENSSL_ENABLE_CHACHA=y
BR2_PACKAGE_LIBOPENSSL_ENABLE_RC2=y
BR2_PACKAGE_LIBOPENSSL_ENABLE_RC4=y
BR2_PACKAGE_LIBOPENSSL_ENABLE_MD2=y
BR2_PACKAGE_LIBOPENSSL_ENABLE_MD4=y
BR2_PACKAGE_LIBOPENSSL_ENABLE_MDC2=y
BR2_PACKAGE_LIBOPENSSL_ENABLE_BLAKE2=y
BR2_PACKAGE_LIBOPENSSL_ENABLE_IDEA=y
BR2_PACKAGE_LIBOPENSSL_ENABLE_SEED=y
BR2_PACKAGE_LIBOPENSSL_ENABLE_DES=y
BR2_PACKAGE_LIBOPENSSL_ENABLE_RMD160=y
BR2_PACKAGE_LIBOPENSSL_ENABLE_WHIRLPOOL=y
BR2_PACKAGE_LIBOPENSSL_ENABLE_BLOWFISH=y
BR2_PACKAGE_LIBOPENSSL_ENABLE_SSL=y
BR2_PACKAGE_LIBOPENSSL_ENABLE_SSL3=y
BR2_PACKAGE_LIBOPENSSL_ENABLE_WEAK_SSL=y
BR2_PACKAGE_LIBOPENSSL_ENABLE_PSK=y
BR2_PACKAGE_LIBOPENSSL_ENABLE_CAST=y
BR2_PACKAGE_LIBOPENSSL_UNSECURE=y
BR2_PACKAGE_LIBOPENSSL_DYNAMIC_ENGINE=y
BR2_PACKAGE_LIBOPENSSL_ENABLE_COMP=y
BR2_PACKAGE_GNUPG=y
BR2_PACKAGE_GNUPG_AES=y
BR2_PACKAGE_GNUPG_RSA=y
BR2_PACKAGE_GNUPG_GPGV=y
BR2_PACKAGE_GNUPG_GPGSPLIT=y
BR2_PACKAGE_GNUPG2_DEPENDS=y


BR2_PACKAGE_NCURSES=y
BR2_PACKAGE_NCURSES_WCHAR=y
BR2_PACKAGE_NCURSES_TARGET_PROGS=y
BR2_PACKAGE_NCURSES_ADDITIONAL_TERMINFO=""
BR2_PACKAGE_PCRE=y
BR2_PACKAGE_PCRE2=y
BR2_PACKAGE_POPT=y
BR2_PACKAGE_READLINE=y
BR2_PACKAGE_BC=y
BR2_PACKAGE_DIALOG=y

#

# =============================================================================
# Scripting Languages
# =============================================================================
BR2_PACKAGE_JANET=y
BR2_PACKAGE_JIMTCL=y
BR2_PACKAGE_LPEG=y

# =============================================================================
# Fonts
# =============================================================================
BR2_PACKAGE_NANUM_FONT=y
BR2_PACKAGE_NOTO_CJK_FONTS=y

# =============================================================================
# Gaming/Emulation Support Libraries
# =============================================================================
# BR2_PACKAGE_GL4ES=y
# BR2_PACKAGE_LIBCAPSIMAGE=y

# =============================================================================
# X11/Windowing runtime (required by Wine/PortMaster 32-bit userspace)
# =============================================================================
BR2_PACKAGE_XORG7=y
BR2_PACKAGE_XLIB_LIBX11=y
BR2_PACKAGE_XLIB_LIBXEXT=y
BR2_PACKAGE_XLIB_LIBXCOMPOSITE=y
BR2_PACKAGE_XLIB_LIBXXF86VM=y
BR2_PACKAGE_XLIB_LIBXDAMAGE=y
BR2_PACKAGE_XLIB_LIBXFIXES=y
BR2_PACKAGE_XLIB_LIBXCURSOR=y
BR2_PACKAGE_XLIB_LIBXI=y
BR2_PACKAGE_XLIB_LIBXRANDR=y
BR2_PACKAGE_XLIB_LIBXRENDER=y
BR2_PACKAGE_LIBXCB=y
BR2_PACKAGE_LIBXKBCOMMON=y
BR2_PACKAGE_CUPS=y
BR2_PACKAGE_VULKAN_HEADERS=y
BR2_PACKAGE_VULKAN_LOADER=y
BR2_PACKAGE_MESA3D_OPENGL_GLX=y
BR2_PACKAGE_XUTIL_UTIL_MACROS=y

# =============================================================================
# Qt Support (headers/features detection)
# =============================================================================
BR2_PACKAGE_QT5_GL_AVAILABLE=y
BR2_PACKAGE_QT5_JSCORE_AVAILABLE=y
BR2_PACKAGE_QT6_GL_SUPPORTS=y

### from board file ###
# SPDX-FileCopyrightText: Added/modified by suckbluefrog
# batocera-zen3_i386_libs.board
# 32-bit i386 library build for zen3 x86_64 targets
# Produces libraries to be injected at /lib32 on the 64-bit image.


# Target definition - 32-bit x86 userspace
BR2_x86_i686=y
BR2_PACKAGE_BATOCERA_TARGET_X86=y
BR2_TARGET_OPTIMIZATION="-pipe -fsigned-char"
BR2_TARGET_GENERIC_GETTY_BAUDRATE_115200=y
BR2_GLOBAL_PATCH_DIR="$(BR2_EXTERNAL_BATOCERA_PATH)/board/batocera/patches $(BR2_EXTERNAL_BATOCERA_PATH)/board/batocera/x86/patches"

# Keep ABI in sync with zen3 base image
BR2_KERNEL_HEADERS_6_18=y
BR2_INSTALL_LIBSTDCPP=y
```

## package/batocera/controllers/pads/gamepadcalibration/Config.in
```kconfig
config BR2_PACKAGE_GAMEPAD_CALIBRATION
	bool "gamepadcalibration"
	depends on BR2_PACKAGE_BATOCERA_TARGET_SM8550 || BR2_PACKAGE_BATOCERA_TARGET_SM8250
	depends on BR2_PACKAGE_HOST_RUSTC_TARGET_ARCH_SUPPORTS
	select BR2_PACKAGE_PYTHON3
	select BR2_PACKAGE_PYTHON_PYXEL
	help
	  GPcal gamepad calibration utility for Qualcomm RSInput handhelds.
	  It writes calibration values to /sys/module/rsinput/parameters
	  and persists them under /userdata/system/configs/rsinput.

comment "gamepadcalibration needs Rust target support"
	depends on BR2_PACKAGE_BATOCERA_TARGET_SM8550 || BR2_PACKAGE_BATOCERA_TARGET_SM8250
	depends on !BR2_PACKAGE_HOST_RUSTC_TARGET_ARCH_SUPPORTS
```

## package/batocera/core/batocera-splash-odin3/Config.in
```kconfig
config BR2_PACKAGE_BATOCERA_SPLASH_ODIN3
    bool "batocera-splash-odin3"
    depends on BR2_PACKAGE_BATOCERA_TARGET_SM8750
    depends on BR2_PACKAGE_BATOCERA_SPLASH
    help
      Odin 3 splash images for sm8750.
```

## package/batocera/core/batocera-splash-sm8550/Config.in
```kconfig
config BR2_PACKAGE_BATOCERA_SPLASH_SM8550
    bool "batocera-splash-sm8550"
    depends on BR2_PACKAGE_BATOCERA_TARGET_SM8550
    depends on BR2_PACKAGE_BATOCERA_SPLASH
    help
      sm8550 splash images.
```

## package/batocera/core/batocera-usbgadget/Config.in
```kconfig
config BR2_PACKAGE_BATOCERA_USBGADGET
	bool "batocera-usbgadget"
	depends on BR2_PACKAGE_BATOCERA_TARGET_SM8X50
	depends on BR2_USE_MMU
	depends on BR2_TOOLCHAIN_HAS_THREADS
	depends on BR2_TOOLCHAIN_HEADERS_AT_LEAST_3_15
	select BR2_PACKAGE_DNSMASQ
	select BR2_PACKAGE_DNSMASQ_DHCP
	select BR2_PACKAGE_IPROUTE2
	select BR2_PACKAGE_UMTPRD
	help
	  USB gadget modes for handheld/device targets.

	  Provides MTP file transfer and USB NCM networking.
```
