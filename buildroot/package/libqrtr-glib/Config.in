## package/batocera/emulators/aethersx2/Config.in
```kconfig
config BR2_PACKAGE_AETHERSX2
    bool "aethersx2"
    depends on BR2_aarch64
    depends on BR2_PACKAGE_HAS_GLES3 || BR2_PACKAGE_BATOCERA_VULKAN
    select BR2_PACKAGE_BATOCERA_QT6
    select BR2_PACKAGE_LIBAIO
    select BR2_PACKAGE_LIBCURL
    select BR2_PACKAGE_LIBPCAP
    select BR2_PACKAGE_LIBPNG
    select BR2_PACKAGE_SDL2
    select BR2_PACKAGE_XLIB_LIBXRANDR if BR2_PACKAGE_XORG7
    select BR2_PACKAGE_XZ
    select BR2_PACKAGE_ZLIB

    help
      AetherSX2 is an aarch64 closed-source fork of the PCSX2 PlayStation 2
      emulator.

      This package installs the ROCKNIX native aarch64 tarball instead of
      building AetherSX2 from source.
```

## package/batocera/emulators/ares/Config.in
```kconfig
config BR2_PACKAGE_ARES
	bool "ares"
	depends on BR2_PACKAGE_BATOCERA_TARGET_SM8550
	depends on BR2_INSTALL_LIBSTDCPP
	depends on BR2_PACKAGE_HOST_RUSTC_ARCH_SUPPORTS # libgtk3
	depends on BR2_USE_WCHAR # libgtk3
	depends on BR2_TOOLCHAIN_HAS_THREADS # libgtk3
	depends on BR2_USE_MMU # libgtk3
	depends on BR2_TOOLCHAIN_HAS_SYNC_4 # libgtk3
	depends on BR2_TOOLCHAIN_GCC_AT_LEAST_4_9 # libgtk3/openal
	depends on BR2_PACKAGE_HAS_LIBEGL || BR2_PACKAGE_HAS_LIBGL # libgtk3
	depends on BR2_TOOLCHAIN_HAS_THREADS_NPTL # openal
	depends on BR2_PACKAGE_OPENAL_ARCH_SUPPORTS
	select BR2_PACKAGE_LIBAO
	select BR2_PACKAGE_LIBGTK3
	select BR2_PACKAGE_OPENAL
	select BR2_PACKAGE_SDL3
	select BR2_PACKAGE_SDL3_WAYLAND if BR2_PACKAGE_WAYLAND
	select BR2_PACKAGE_ZLIB
	help
	  Ares is a multi-system emulator descended from higan and bsnes.

	  https://ares-emu.net/
```

## package/batocera/emulators/armsx2-masies/Config.in
```kconfig
config BR2_PACKAGE_ARMSX2_MASIES
    bool "armsx2-masies"
    depends on BR2_aarch64
    depends on BR2_PACKAGE_HAS_UDEV
    depends on BR2_PACKAGE_XORG7
    depends on BR2_PACKAGE_HAS_LIBGL || BR2_PACKAGE_BATOCERA_VULKAN
    depends on BR2_PACKAGE_BATOCERA_TARGET_SM8X50 || BR2_PACKAGE_BATOCERA_TARGET_SM8250 || BR2_PACKAGE_BATOCERA_TARGET_QCS6490 || BR2_PACKAGE_BATOCERA_TARGET_RK3588
    select BR2_PACKAGE_ALSA_LIB
    select BR2_PACKAGE_BATOCERA_QT6
    select BR2_PACKAGE_DBUS
    select BR2_PACKAGE_ECM
    select BR2_PACKAGE_FMT
    select BR2_PACKAGE_FONTCONFIG
    select BR2_PACKAGE_FREETYPE
    select BR2_PACKAGE_JPEG
    select BR2_PACKAGE_JPEG_TURBO
    select BR2_PACKAGE_KDDOCKWIDGETS
    select BR2_PACKAGE_LIBAIO
    select BR2_PACKAGE_LIBBACKTRACE
    select BR2_PACKAGE_LIBCURL
    select BR2_PACKAGE_LIBGTK3
    select BR2_PACKAGE_LIBPCAP
    select BR2_PACKAGE_LIBPNG
    select BR2_PACKAGE_LIBSAMPLERATE
    select BR2_PACKAGE_LIBSOUNDTOUCH
    select BR2_PACKAGE_LZ4
    select BR2_PACKAGE_PLUTOSVG
    select BR2_PACKAGE_PORTAUDIO
    select BR2_PACKAGE_RAPIDYAML
    select BR2_PACKAGE_SDL3
    select BR2_PACKAGE_SDL3_OPENGLES if BR2_PACKAGE_HAS_LIBGLES
    select BR2_PACKAGE_SDL3_OPENGL if BR2_PACKAGE_HAS_LIBGL
    select BR2_PACKAGE_SDL3_X11
    select BR2_PACKAGE_SHADERC if BR2_PACKAGE_BATOCERA_VULKAN
    select BR2_PACKAGE_VULKAN_HEADERS if BR2_PACKAGE_BATOCERA_VULKAN
    select BR2_PACKAGE_VULKAN_LOADER if BR2_PACKAGE_BATOCERA_VULKAN
    select BR2_PACKAGE_WAYLAND_PROTOCOLS if BR2_PACKAGE_WAYLAND
    select BR2_PACKAGE_WEBP
    select BR2_PACKAGE_XLIB_LIBX11 if BR2_PACKAGE_XORG7
    select BR2_PACKAGE_XLIB_LIBXEXT if BR2_PACKAGE_XORG7
    select BR2_PACKAGE_XLIB_LIBXI if BR2_PACKAGE_XORG7
    select BR2_PACKAGE_XLIB_LIBXRANDR if BR2_PACKAGE_XORG7
    select BR2_PACKAGE_XLIB_LIBXRENDER if BR2_PACKAGE_XORG7
    select BR2_PACKAGE_WXWIDGETS
    select BR2_PACKAGE_YAML_CPP
    select BR2_PACKAGE_ZLIB
    select BR2_PACKAGE_ZSTD
    help
      Linux ARM64 desktop ARMSX2 branch with macrec ARM64 JIT
      work and GLES fixes.

      https://github.com/suckbluefrog/ARMSX2-LINUX-FOR-BATOCERA/tree/v34-integration
```

## package/batocera/emulators/armsx2/Config.in
```kconfig
config BR2_PACKAGE_ARMSX2
    bool "armsx2"
    depends on BR2_aarch64
    depends on BR2_PACKAGE_HAS_UDEV
    depends on BR2_PACKAGE_XORG7
    depends on BR2_PACKAGE_HAS_LIBGL || BR2_PACKAGE_BATOCERA_VULKAN
    depends on BR2_PACKAGE_BATOCERA_TARGET_SM8X50 || BR2_PACKAGE_BATOCERA_TARGET_SM8250 || BR2_PACKAGE_BATOCERA_TARGET_QCS6490 || BR2_PACKAGE_BATOCERA_TARGET_RK3588
    select BR2_PACKAGE_ALSA_LIB
    select BR2_PACKAGE_BATOCERA_QT6
    select BR2_PACKAGE_DBUS
    select BR2_PACKAGE_ECM
    select BR2_PACKAGE_FMT
    select BR2_PACKAGE_FONTCONFIG
    select BR2_PACKAGE_FREETYPE
    select BR2_PACKAGE_KDDOCKWIDGETS
    select BR2_PACKAGE_LIBAIO
    select BR2_PACKAGE_LIBBACKTRACE
    select BR2_PACKAGE_LIBCURL
    select BR2_PACKAGE_LIBGTK3
    select BR2_PACKAGE_LIBPCAP
    select BR2_PACKAGE_LIBPNG
    select BR2_PACKAGE_LIBSAMPLERATE
    select BR2_PACKAGE_LIBSOUNDTOUCH
    select BR2_PACKAGE_PLUTOSVG
    select BR2_PACKAGE_PORTAUDIO
    select BR2_PACKAGE_SDL3
    select BR2_PACKAGE_SDL3_OPENGLES if BR2_PACKAGE_HAS_LIBGLES
    select BR2_PACKAGE_SDL3_OPENGL if BR2_PACKAGE_HAS_LIBGL
    select BR2_PACKAGE_SDL3_X11
    select BR2_PACKAGE_SHADERC if BR2_PACKAGE_BATOCERA_VULKAN
    select BR2_PACKAGE_VULKAN_HEADERS if BR2_PACKAGE_BATOCERA_VULKAN
    select BR2_PACKAGE_VULKAN_LOADER if BR2_PACKAGE_BATOCERA_VULKAN
    select BR2_PACKAGE_WAYLAND_PROTOCOLS if BR2_PACKAGE_WAYLAND
    select BR2_PACKAGE_WEBP
    select BR2_PACKAGE_XLIB_LIBX11 if BR2_PACKAGE_XORG7
    select BR2_PACKAGE_XLIB_LIBXEXT if BR2_PACKAGE_XORG7
    select BR2_PACKAGE_XLIB_LIBXI if BR2_PACKAGE_XORG7
    select BR2_PACKAGE_XLIB_LIBXRANDR if BR2_PACKAGE_XORG7
    select BR2_PACKAGE_XLIB_LIBXRENDER if BR2_PACKAGE_XORG7
    select BR2_PACKAGE_WXWIDGETS
    select BR2_PACKAGE_YAML_CPP
    select BR2_PACKAGE_ZLIB
    help
      ARMSX2 is a PCSX2 fork with a native ARM64 JIT for PlayStation 2 emulation.

      https://github.com/ARMSX2/ARMSX2
```

## package/batocera/emulators/eden/Config.in
```kconfig
config BR2_PACKAGE_EDEN
	bool "Eden (Nintendo Switch)"
	depends on BR2_aarch64
	help
	  Eden Nintendo Switch emulator.

	  This package installs the published Linux AppImage and wraps it with
	  a Batocera runtime launcher under /usr/bin/eden.

if BR2_PACKAGE_EDEN

config BR2_PACKAGE_EDEN_NATIVE
	bool "Build native Eden"
	depends on BR2_INSTALL_LIBSTDCPP
	depends on BR2_PACKAGE_QT6_ARCH_SUPPORTS
	depends on BR2_TOOLCHAIN_GCC_AT_LEAST_8
	depends on BR2_HOST_GCC_AT_LEAST_8
	depends on BR2_TOOLCHAIN_HAS_THREADS
	depends on !BR2_STATIC_LIBS
	depends on BR2_USE_WCHAR
	depends on BR2_PACKAGE_XORG7
	select BR2_PACKAGE_BOOST
	select BR2_PACKAGE_BOOST_CONTAINER
	select BR2_PACKAGE_BOOST_CONTEXT
	select BR2_PACKAGE_BOOST_FIBER
	select BR2_PACKAGE_BOOST_FILESYSTEM
	select BR2_PACKAGE_BOOST_SYSTEM
	select BR2_PACKAGE_BOOST_THREAD
	select BR2_PACKAGE_FFMPEG
	select BR2_PACKAGE_FFMPEG_SWSCALE
	select BR2_PACKAGE_FMT
	select BR2_PACKAGE_JSON_FOR_MODERN_CPP
	select BR2_PACKAGE_LIBDRM
	select BR2_PACKAGE_LIBDRM_FREEDRENO if BR2_aarch64
	select BR2_PACKAGE_LIBENET
	select BR2_PACKAGE_LIBEVDEV
	select BR2_PACKAGE_LIBOPENSSL
	select BR2_PACKAGE_LIBUSB
	select BR2_PACKAGE_LIBZIP
	select BR2_PACKAGE_LZ4
	select BR2_PACKAGE_OPUS
	select BR2_PACKAGE_QT6
	select BR2_PACKAGE_QT6BASE_CONCURRENT
	select BR2_PACKAGE_QT6BASE_DBUS
	select BR2_PACKAGE_QT6BASE_GUI
	select BR2_PACKAGE_QT6BASE_NETWORK
	select BR2_PACKAGE_QT6BASE_OPENGL if BR2_PACKAGE_HAS_LIBGL
	select BR2_PACKAGE_QT6BASE_OPENGL_DESKTOP if BR2_PACKAGE_HAS_LIBGL
	select BR2_PACKAGE_QT6BASE_VULKAN
	select BR2_PACKAGE_QT6BASE_WIDGETS
	select BR2_PACKAGE_QT6BASE_XCB
	select BR2_PACKAGE_QT6CHARTS
	select BR2_PACKAGE_QUAZIP
	select BR2_PACKAGE_SDL3
	select BR2_PACKAGE_SDL3_OPENGL if BR2_PACKAGE_HAS_LIBGL
	select BR2_PACKAGE_SDL3_X11
	select BR2_PACKAGE_SPIRV_HEADERS
	select BR2_PACKAGE_SPIRV_TOOLS
	select BR2_PACKAGE_VULKAN_HEADERS
	select BR2_PACKAGE_VULKAN_LOADER
	select BR2_PACKAGE_VULKAN_UTILITY_LIBRARIES
	select BR2_PACKAGE_ZLIB
	select BR2_PACKAGE_ZSTD
	help
	  Build the UzuCore Eden standalone frontend natively instead of
	  relying only on the upstream AppImage. The AppImage is still
	  installed for fallback and comparison.

endif
```

## package/batocera/emulators/fex-emu/Config.in
```kconfig
config BR2_PACKAGE_FEX_EMU
	bool "fex-emu"
	depends on BR2_aarch64
	select BR2_PACKAGE_ALSA_LIB
	select BR2_PACKAGE_EROFS_UTILS
	select BR2_PACKAGE_EROFS_UTILS_EROFSFUSE
	select BR2_PACKAGE_LIBDRM
	select BR2_PACKAGE_LIBGLVND
	select BR2_PACKAGE_MESA3D
	select BR2_PACKAGE_MESA3D_OPENGL_EGL
	select BR2_PACKAGE_OPENSSL
	select BR2_PACKAGE_SQUASHFS
	select BR2_PACKAGE_LLVM
	select BR2_PACKAGE_SQUASHFUSE
	select BR2_PACKAGE_VULKAN_HEADERS
	select BR2_PACKAGE_WAYLAND
	help
	  FEX-Emu is a fast x86 and x86-64 Linux emulator that allows
	  running x86/x86_64 applications on AArch64 Linux systems.

	  This package restores the host-side FEX runtime for explicit
	  invocation on Batocera aarch64 systems.

	  It does not enable FEX binfmt_misc registration by default,
	  allowing existing box64/box32 handlers to remain the default
	  transparent x86/x86_64 executors.

	  https://github.com/FEX-Emu/FEXS

if BR2_PACKAGE_FEX_EMU

config BR2_PACKAGE_FEX_EMU_BINFMT
	bool "install optional FEX binfmt init script"
	help
	  Install the legacy FEX binfmt_misc init script.

	  This is disabled by default so FEX is only used when called
	  explicitly, and existing box64/box32 binfmt registrations are
	  left untouched.

endif
```

## package/batocera/emulators/pcsx2/Config.in
```kconfig
config BR2_PACKAGE_PCSX2
    bool "pcsx2"
    depends on BR2_aarch64
    depends on BR2_PACKAGE_XORG7
    depends on BR2_PACKAGE_BATOCERA_TARGET_SM8X50 || BR2_PACKAGE_BATOCERA_TARGET_SM8250 || BR2_PACKAGE_BATOCERA_TARGET_QCS6490
    select BR2_PACKAGE_ALSA_LIB
    select BR2_PACKAGE_BATOCERA_QT6
    select BR2_PACKAGE_FFMPEG
    select BR2_PACKAGE_FMT
    select BR2_PACKAGE_DEJAVU
    select BR2_PACKAGE_ECM
    select BR2_PACKAGE_FREETYPE
    select BR2_PACKAGE_KDDOCKWIDGETS
    select BR2_PACKAGE_LIBAIO
    select BR2_PACKAGE_LIBBACKTRACE
    select BR2_PACKAGE_LIBCURL
    select BR2_PACKAGE_LIBGTK3
    select BR2_PACKAGE_JPEG
    select BR2_PACKAGE_JPEG_TURBO
    select BR2_PACKAGE_LIBPCAP
    select BR2_PACKAGE_LIBPNG
    select BR2_PACKAGE_LIBSAMPLERATE
    select BR2_PACKAGE_LIBSOUNDTOUCH
    select BR2_PACKAGE_LZ4
    select BR2_PACKAGE_PLUTOSVG
    select BR2_PACKAGE_PORTAUDIO
    select BR2_PACKAGE_SDL3
    select BR2_PACKAGE_SHADERC
    select BR2_PACKAGE_VULKAN_HEADERS    if BR2_PACKAGE_BATOCERA_VULKAN
    select BR2_PACKAGE_VULKAN_LOADER     if BR2_PACKAGE_BATOCERA_VULKAN
    select BR2_PACKAGE_WAYLAND_PROTOCOLS if BR2_PACKAGE_WAYLAND
    select BR2_PACKAGE_WEBP
    select BR2_PACKAGE_WXWIDGETS
    select BR2_PACKAGE_XLIB_LIBX11       if BR2_PACKAGE_XORG7
    select BR2_PACKAGE_XLIB_LIBXEXT      if BR2_PACKAGE_XORG7
    select BR2_PACKAGE_YAML_CPP
    select BR2_PACKAGE_ZLIB
    select BR2_PACKAGE_ZSTD
    help
      PCSX2 is a free and open-source PlayStation 2 (PS2) emulator.

      https://github.com/yaps2/yaps2
```

## package/batocera/emulators/pkmnrecomp/Config.in
```kconfig
config BR2_PACKAGE_PKMNRECOMP
	bool "pkmnrecomp"
	depends on BR2_aarch64
	depends on BR2_TOOLCHAIN_USES_GLIBC
	depends on !BR2_STATIC_LIBS
	select BR2_PACKAGE_SDL2
	help
	  Pokemon Recomp launcher for EmulationStation.

	  Ships the official ARM64 AppImages for gen1recomp (Red/Blue/Yellow)
	  and Gen2Recomped (Gold/Silver/Crystal). The player supplies a
	  canonical US ROM; nothing is bundled. First launch imports by SHA-1
	  without a file picker.

	  https://github.com/bryanthaboi/gen1recomp
	  https://github.com/UNDERdecoded/Gen2Recomped

comment "pkmnrecomp needs an aarch64 glibc toolchain"
	depends on !BR2_aarch64 || !BR2_TOOLCHAIN_USES_GLIBC || BR2_STATIC_LIBS
```

## package/batocera/emulators/shadps4-fex/Config.in
```kconfig
config BR2_PACKAGE_SHADPS4_FEX
	bool "shadps4-fex"
	depends on BR2_aarch64
	select BR2_PACKAGE_FEX_EMU
	help
	  FEX launcher support for the x86_64 Linux shadPS4 build on
	  AArch64 Batocera systems.

	  This package does not build shadPS4 for AArch64. It installs a
	  launcher that runs an x86-64 shadPS4 payload through FEX-Emu.
	  SM8X50 images can inject the matching x86-64-v3 rootfs from the
	  *_x86_64_v3_shadps4 side build during post-build.

if BR2_PACKAGE_SHADPS4_FEX

config BR2_PACKAGE_SHADPS4_FEX_PAYLOAD_PATH
	string "prebuilt x86_64 shadPS4 payload path"
	default ""
	help
	  Optional directory containing the x86_64 shadPS4 payload to copy
	  into the target image.

	  The normal SM8X50 path is to build a matching
	  *_x86_64_v3_shadps4 side rootfs and let the post-build injector
	  install it under /usr/share/batocera/apps/shadps4-fex-rootfs.

	  Leave this path missing to install the launcher only. In that case,
	  place the x86_64 payload at /userdata/system/shadps4-x86_64.

endif
```

## package/batocera/emulators/shadps4-qtlauncher/Config.in
```kconfig
config BR2_PACKAGE_SHADPS4_QTLAUNCHER
	bool "shadps4-qtlauncher"
	depends on BR2_x86_64
	depends on BR2_TOOLCHAIN_GCC_AT_LEAST_13
	select BR2_HOST_CMAKE_AT_LEAST_3_24
	select BR2_PACKAGE_OPENSSL
	select BR2_PACKAGE_SDL3
	select BR2_PACKAGE_VULKAN_HEADERS
	select BR2_PACKAGE_QT6
	select BR2_PACKAGE_QT6_VERSION_LATEST
	select BR2_PACKAGE_QT6BASE
	select BR2_PACKAGE_QT6BASE_CONCURRENT
	select BR2_PACKAGE_QT6BASE_FONTCONFIG
	select BR2_PACKAGE_QT6BASE_GUI
	select BR2_PACKAGE_QT6BASE_NETWORK
	select BR2_PACKAGE_QT6BASE_WIDGETS
	select BR2_PACKAGE_QT6BASE_VULKAN
	select BR2_PACKAGE_QT6BASE_OPENGL if BR2_PACKAGE_HAS_LIBGL || BR2_PACKAGE_HAS_LIBGLES
	select BR2_PACKAGE_QT6BASE_OPENGL_DESKTOP if BR2_PACKAGE_HAS_LIBGL
	select BR2_PACKAGE_QT6BASE_OPENGL_ES2 if BR2_PACKAGE_HAS_LIBGLES
	select BR2_PACKAGE_QT6MULTIMEDIA
	select BR2_PACKAGE_QT6TOOLS
	select BR2_PACKAGE_QT6WAYLAND if BR2_PACKAGE_BATOCERA_WAYLAND
	help
	  Qt launcher companion for shadPS4.

	  https://github.com/shadps4-emu/shadps4-qtlauncher
```

## package/batocera/emulators/shadps4/Config.in
```kconfig
config BR2_PACKAGE_SHADPS4
    bool "shadps4"
    depends on BR2_TOOLCHAIN_GCC_AT_LEAST_13
    depends on BR2_PACKAGE_FFMPEG_ARCH_SUPPORTS
    depends on BR2_TOOLCHAIN_HAS_THREADS # ffmpeg
    depends on BR2_TOOLCHAIN_SUPPORTS_ALWAYS_LOCKFREE_ATOMIC_INTS # boost-atomic, boost-filesystem
    select BR2_HOST_CMAKE_AT_LEAST_3_24
    select BR2_PACKAGE_ALSA_LIB
    select BR2_PACKAGE_BATOCERA_RETROACHIEVEMENTS_SOUNDS
    select BR2_PACKAGE_BOOST
    select BR2_PACKAGE_BOOST_ATOMIC
    select BR2_PACKAGE_BOOST_CONTEXT
    select BR2_PACKAGE_BOOST_DATE_TIME
    select BR2_PACKAGE_BOOST_EXCEPTION
    select BR2_PACKAGE_BOOST_FILESYSTEM
    select BR2_PACKAGE_BOOST_RANDOM
    select BR2_PACKAGE_FFMPEG
    select BR2_PACKAGE_FFMPEG_SWSCALE
    select BR2_PACKAGE_PULSEAUDIO
    select BR2_PACKAGE_OPENAL
    select BR2_PACKAGE_OPENSSL
    select BR2_PACKAGE_LIBZLIB
    select BR2_PACKAGE_LIBEDIT
    select BR2_PACKAGE_UDEV
    select BR2_PACKAGE_LIBEVDEV
    select BR2_PACKAGE_JACK2
    select BR2_PACKAGE_QT6BASE
    select BR2_PACKAGE_QT6SVG
    select BR2_PACKAGE_QT6TOOLS
    select BR2_PACKAGE_QT6MULTIMEDIA
    select BR2_PACKAGE_SDL3
    select BR2_PACKAGE_UTIL_LINUX_LIBS
    select BR2_PACKAGE_UTIL_LINUX_LIBUUID
    select BR2_PACKAGE_VULKAN_HEADERS
    select BR2_PACKAGE_VULKAN_LOADER
    select BR2_PACKAGE_VULKAN_VALIDATIONLAYERS
    help
      Sony Playstation 4 emulator.

      https://github.com/shadps4-emu/shadPS4
      https://shadps4.net/
```
