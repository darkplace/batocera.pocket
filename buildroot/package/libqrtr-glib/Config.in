## configs/batocera-rk3568_armhf_libs_defconfig
```kconfig
# SPDX-FileCopyrightText: Added/modified by suckbluefrog
# from file batocera-board.libs
# batocera-board.libs
# Common configuration for 32-bit armhf library builds
# These builds produce only libraries to be integrated into 64-bit images

# users
BR2_ROOTFS_USERS_TABLES="$(BR2_EXTERNAL_BATOCERA_PATH)/board/batocera/users.txt"

# toolchain definition
BR2_OPTIMIZE_2=y
BR2_ENABLE_LTO=y
BR2_SHARED_STATIC_LIBS=y
BR2_GCC_ENABLE_GRAPHITE=y
BR2_TOOLCHAIN_BUILDROOT_GLIBC=y
BR2_TOOLCHAIN_BUILDROOT_CXX=y
# required for utf-8
BR2_TOOLCHAIN_GLIBC_GCONV_LIBS_COPY=y

# Allow to build GOLD linker, but do not use as default
BR2_BINUTILS_EXTRA_CONFIG_OPTIONS="--enable-gold --enable-plugins"

# Disable busybox - we only need libraries
BR2_PACKAGE_BUSYBOX=n

# system
BR2_TARGET_GENERIC_HOSTNAME="batocera"
BR2_TARGET_GENERIC_ISSUE="batocera-lib32"
BR2_INIT_SYSV=y
BR2_ROOTFS_DEVICE_CREATION_DYNAMIC_EUDEV=y
BR2_TARGET_GENERIC_ROOT_PASSWD="linux"
BR2_SYSTEM_ENABLE_NLS=y
BR2_ENABLE_LOCALE_WHITELIST="C en"
BR2_GENERATE_LOCALE="en_US.UTF-8"
BR2_TARGET_TZ_INFO=y
BR2_TARGET_LOCALTIME="Europe/Paris"
# BR2_TARGET_GENERIC_REMOUNT_ROOTFS_RW is not set

# Initramfs decompression support
BR2_LINUX_KERNEL_LZ4=y

# disable the mosquitto broker which is on by default
BR2_PACKAGE_MOSQUITTO_BROKER=n

# Disable full system packages - we only want libraries
BR2_PACKAGE_BATOCERA_SYSTEM=n
BR2_PACKAGE_BATOCERA_EXTRAS=n
BR2_PACKAGE_BATOCERA_TOOLS=n
BR2_PACKAGE_BATOCERA_ALL_SYSTEMS=n
BR2_PACKAGE_BATOCERA_LINUX_FIRMWARES=n
BR2_SYSTEM_BIN_SH_DASH=y

# Build box86 in the armhf pipeline so it can be injected into the
# corresponding 64-bit image alongside /lib32.
BR2_PACKAGE_BOX86=y

# Build tar file only - no image, no squashfs
BR2_TARGET_ROOTFS_TAR=y
BR2_TARGET_ROOTFS_TAR_NONE=y

# Enables ccache
BR2_CCACHE=y

# Don't purge locales
BR2_ENABLE_LOCALE_PURGE=n

# from file batocera-rk3588_armhf_libs.packages
# batocera-rk3588_armhf_libs.packages
# 32-bit library packages for RK3588 multilib support
# Adapted from knulli packages list with rockchip additions

# =============================================================================
# Audio - ALSA
# =============================================================================
BR2_PACKAGE_ALSA_LIB=y
BR2_PACKAGE_ALSA_LIB_DEVDIR="/dev/snd"
BR2_PACKAGE_ALSA_LIB_PCM_PLUGINS="all"
BR2_PACKAGE_ALSA_LIB_CTL_PLUGINS="all"
BR2_PACKAGE_ALSA_LIB_ALOAD=y
BR2_PACKAGE_ALSA_LIB_MIXER=y
BR2_PACKAGE_ALSA_LIB_PCM=y
BR2_PACKAGE_ALSA_LIB_RAWMIDI=y
BR2_PACKAGE_ALSA_LIB_HWDEP=y
BR2_PACKAGE_ALSA_LIB_SEQ=y
BR2_PACKAGE_ALSA_LIB_UCM=y
BR2_PACKAGE_ALSA_LIB_ALISP=y
BR2_PACKAGE_ALSA_LIB_OLD_SYMBOLS=y
BR2_PACKAGE_ALSA_LIB_TOPOLOGY=y
BR2_PACKAGE_ALSA_PLUGINS=y
BR2_PACKAGE_ALSA_UCM_CONF=y
BR2_PACKAGE_ALSA_UTILS=y
BR2_PACKAGE_ALSA_UTILS_ACONNECT=y
BR2_PACKAGE_ALSA_UTILS_ALSACTL=y
BR2_PACKAGE_ALSA_UTILS_ALSAMIXER=y
BR2_PACKAGE_ALSA_UTILS_ALSAUCM=y
BR2_PACKAGE_ALSA_UTILS_AMIXER=y
BR2_PACKAGE_ALSA_UTILS_APLAY=y
BR2_PACKAGE_ALSA_UTILS_APLAYMIDI=y
BR2_PACKAGE_ALSA_UTILS_ALSAINFO=y

# =============================================================================
# Audio - PulseAudio/PipeWire
# =============================================================================
BR2_PACKAGE_PULSEAUDIO_HAS_ATOMIC=y
BR2_PACKAGE_PULSEAUDIO_ENABLE_ATOMIC=y
BR2_PACKAGE_PULSEAUDIO=y
BR2_PACKAGE_PIPEWIRE=y
BR2_PACKAGE_PIPEWIRE_GSTREAMER=y
BR2_PACKAGE_PIPEWIRE_V4L2=y
BR2_PACKAGE_WIREPLUMBER=y

# =============================================================================
# Audio - Codecs and Libraries
# =============================================================================
BR2_PACKAGE_ESPEAK=y
BR2_PACKAGE_ESPEAK_AUDIO_BACKEND_ALSA=y
BR2_PACKAGE_FAAD2=y
BR2_PACKAGE_FDK_AAC=y
BR2_PACKAGE_FLAC=y
BR2_PACKAGE_FLUID_SOUNDFONT=y
BR2_PACKAGE_FLUIDSYNTH=y
BR2_PACKAGE_FLUIDSYNTH_ALSA_LIB=y
BR2_PACKAGE_FLUIDSYNTH_SDL2=y
BR2_PACKAGE_LAME=y
BR2_PACKAGE_LIBAO=y
BR2_PACKAGE_LIBMAD=y
BR2_PACKAGE_LIBMAD_OPTIMIZATION_DEFAULT=y
BR2_PACKAGE_LIBMAD_ASO=y
BR2_PACKAGE_LIBMODPLUG=y
BR2_PACKAGE_LIBSAMPLERATE=y
BR2_PACKAGE_LIBSNDFILE=y
BR2_PACKAGE_LIBVORBIS=y
BR2_PACKAGE_MPG123=y
BR2_PACKAGE_OPENAL=y
BR2_PACKAGE_OPUS=y
BR2_PACKAGE_OPUSFILE=y
BR2_PACKAGE_PORTAUDIO=y
BR2_PACKAGE_PORTAUDIO_ALSA=y
BR2_PACKAGE_PORTAUDIO_CXX=y
BR2_PACKAGE_SBC=y
BR2_PACKAGE_SPEEXDSP=y
BR2_PACKAGE_VO_AACENC=y
BR2_PACKAGE_LIBFREEAPTX=y
BR2_PACKAGE_LIBLDAC=y
BR2_PACKAGE_LIBLC3=y
BR2_PACKAGE_WILDMIDI=y
BR2_PACKAGE_ZMUSIC=y
BR2_PACKAGE_LIBXMP=y

# =============================================================================
# Video - FFmpeg (standard)
# =============================================================================
BR2_PACKAGE_FFMPEG=y
BR2_PACKAGE_FFMPEG_GPL=y
BR2_PACKAGE_FFMPEG_FFMPEG=y
BR2_PACKAGE_FFMPEG_FFPROBE=y
BR2_PACKAGE_FFMPEG_POSTPROC=y
BR2_PACKAGE_FFMPEG_SWSCALE=y
BR2_PACKAGE_FFMPEG_ENCODERS="all"
BR2_PACKAGE_FFMPEG_DECODERS="all"
BR2_PACKAGE_FFMPEG_MUXERS="all"
BR2_PACKAGE_FFMPEG_DEMUXERS="all"
BR2_PACKAGE_FFMPEG_PARSERS="all"
BR2_PACKAGE_FFMPEG_BSFS="all"
BR2_PACKAGE_FFMPEG_PROTOCOLS="all"
BR2_PACKAGE_FFMPEG_FILTERS="all"
BR2_PACKAGE_FFMPEG_INDEVS=y
BR2_PACKAGE_FFMPEG_OUTDEVS=y
BR2_PACKAGE_FFMPEG_EXTRACONF=""

# =============================================================================
# Video - FFmpeg Rockchip (hardware acceleration)
# =============================================================================
BR2_PACKAGE_FFMPEG_ROCKCHIP=y
BR2_PACKAGE_FFMPEG_ROCKCHIP_FFMPEG=y
BR2_PACKAGE_FFMPEG_ROCKCHIP_ENCODERS="all"
BR2_PACKAGE_FFMPEG_ROCKCHIP_DECODERS="all"
BR2_PACKAGE_FFMPEG_ROCKCHIP_MUXERS="all"
BR2_PACKAGE_FFMPEG_ROCKCHIP_DEMUXERS="all"
BR2_PACKAGE_FFMPEG_ROCKCHIP_PARSERS="all"
BR2_PACKAGE_FFMPEG_ROCKCHIP_BSFS="all"
BR2_PACKAGE_FFMPEG_ROCKCHIP_PROTOCOLS="all"
BR2_PACKAGE_FFMPEG_ROCKCHIP_FILTERS="all"
BR2_PACKAGE_FFMPEG_ROCKCHIP_INDEVS=y
BR2_PACKAGE_FFMPEG_ROCKCHIP_OUTDEVS=y
BR2_PACKAGE_FFMPEG_ROCKCHIP_EXTRACONF=""

# =============================================================================
# Video - Rockchip MPP/RGA (hardware codec support)
# =============================================================================
BR2_PACKAGE_ROCKCHIP_MPP=y
BR2_PACKAGE_ROCKCHIP_RGA=y

# =============================================================================
# Video - GStreamer
# =============================================================================
BR2_PACKAGE_GSTREAMER1=y
BR2_PACKAGE_GSTREAMER1_PARSE=y
BR2_PACKAGE_GSTREAMER1_TRACE=y
BR2_PACKAGE_GSTREAMER1_GST_DEBUG=y
BR2_PACKAGE_GSTREAMER1_PLUGIN_REGISTRY=y
BR2_PACKAGE_GSTREAMER1_INSTALL_TOOLS=y
BR2_PACKAGE_GST1_PLUGINS_BASE=y
BR2_PACKAGE_GST1_PLUGINS_BASE_PLUGIN_APP=y
BR2_PACKAGE_GST1_PLUGINS_BASE_PLUGIN_AUDIOCONVERT=y
BR2_PACKAGE_GST1_PLUGINS_BASE_PLUGIN_ENCODING=y
BR2_PACKAGE_GST1_PLUGINS_BASE_PLUGIN_VIDEOCONVERTSCALE=y
BR2_PACKAGE_GST1_PLUGINS_BASE_PLUGIN_PLAYBACK=y
BR2_PACKAGE_GST1_PLUGINS_BASE_PLUGIN_AUDIORESAMPLE=y
BR2_PACKAGE_GST1_PLUGINS_BASE_PLUGIN_TYPEFIND=y
BR2_PACKAGE_GST1_PLUGINS_BASE_PLUGIN_VOLUME=y
BR2_PACKAGE_GST1_PLUGINS_GOOD=y
BR2_PACKAGE_GST1_PLUGINS_GOOD_PLUGIN_AVI=y
BR2_PACKAGE_GST1_PLUGINS_GOOD_PLUGIN_ISOMP4=y
BR2_PACKAGE_GST1_PLUGINS_GOOD_PLUGIN_WAVPARSE=y
BR2_PACKAGE_GST1_PLUGINS_GOOD_PLUGIN_V4L2=y
BR2_PACKAGE_GST1_PLUGINS_GOOD_PLUGIN_V4L2_PROBE=y
BR2_PACKAGE_GST1_PLUGINS_BAD=y
BR2_PACKAGE_GST1_PLUGINS_BAD_PLUGIN_ADPCMDEC=y
BR2_PACKAGE_GST1_PLUGINS_BAD_PLUGIN_ADPCMENC=y
BR2_PACKAGE_GST1_PLUGINS_BAD_PLUGIN_MIDI=y
BR2_PACKAGE_GST1_PLUGINS_BAD_PLUGIN_FAAD=y
BR2_PACKAGE_GST1_PLUGINS_BAD_PLUGIN_FDK_AAC=y
BR2_PACKAGE_GST1_PLUGINS_BAD_PLUGIN_MPEG2ENC=y
BR2_PACKAGE_GST1_PLUGINS_BAD_PLUGIN_OPENAL=y
BR2_PACKAGE_GST1_PLUGINS_BAD_PLUGIN_OPENH264=y
BR2_PACKAGE_GST1_PLUGINS_BAD_PLUGIN_OPUS=y
BR2_PACKAGE_GST1_PLUGINS_BAD_PLUGIN_SBC=y
BR2_PACKAGE_GST1_PLUGINS_BAD_PLUGIN_VOAACENC=y
BR2_PACKAGE_GST1_PLUGINS_BAD_PLUGIN_V4L2CODECS=y
BR2_PACKAGE_GST1_PLUGINS_BAD_PLUGIN_X265=y
BR2_PACKAGE_GST1_PLUGINS_UGLY=y
BR2_PACKAGE_GST1_PLUGINS_UGLY_PLUGIN_MPEG2DEC=y
BR2_PACKAGE_GST1_PLUGINS_UGLY_PLUGIN_X264=y

# =============================================================================
# Video - Codecs
# =============================================================================
BR2_PACKAGE_LIBASS=y
BR2_PACKAGE_LIBMPEG2=y
BR2_PACKAGE_LIBOGG=y
BR2_PACKAGE_LIBOPENH264=y
BR2_PACKAGE_LIBTHEORA=y
BR2_PACKAGE_LIBVPX=y
BR2_PACKAGE_X264=y
BR2_PACKAGE_X265=y
BR2_PACKAGE_MJPEGTOOLS=y
BR2_PACKAGE_LIBPLACEBO=y

# =============================================================================
# Video - Players
# =============================================================================
BR2_PACKAGE_MPV=y
BR2_PACKAGE_VLC=y

# =============================================================================
# Graphics - Image Libraries
# =============================================================================
BR2_PACKAGE_CAIRO=y
BR2_PACKAGE_FONTCONFIG=y
BR2_PACKAGE_FREETYPE=y
BR2_PACKAGE_GIFLIB=y
BR2_PACKAGE_HARFBUZZ=y
BR2_PACKAGE_JPEG_SIMD_SUPPORT=y
BR2_PACKAGE_JPEG=y
BR2_PACKAGE_JPEG_TURBO=y
BR2_PACKAGE_LIBEPOXY=y
BR2_PACKAGE_LIBFREEIMAGE=y
BR2_PACKAGE_LIBPNG=y
BR2_PACKAGE_OPENJPEG=y
BR2_PACKAGE_PANGO=y
BR2_PACKAGE_PIXMAN=y
BR2_PACKAGE_POPPLER=y
BR2_PACKAGE_POPPLER_UTILS=y
BR2_PACKAGE_WEBP=y
BR2_PACKAGE_WEBP_DEMUX=y
BR2_PACKAGE_WEBP_MUX=y
BR2_PACKAGE_LIBGRAPHENE=y

# =============================================================================
# Graphics - OpenCV
# =============================================================================
BR2_PACKAGE_OPENCV4=y
BR2_PACKAGE_OPENCV4_LIB_IMGCODECS=y
BR2_PACKAGE_OPENCV4_LIB_IMGPROC=y
BR2_PACKAGE_OPENCV4_LIB_PYTHON=y
BR2_PACKAGE_OPENCV4_LIB_VIDEOIO=y
BR2_PACKAGE_OPENCV4_LIB_VIDEO=y
BR2_PACKAGE_OPENCV4_WITH_FFMPEG=y
BR2_PACKAGE_OPENCV4_WITH_GSTREAMER1=y
BR2_PACKAGE_OPENCV4_JPEG2000_NONE=y
BR2_PACKAGE_OPENCV4_DISABLE_GAPI=y

# =============================================================================
# Graphics - Framebuffer
# =============================================================================
BR2_PACKAGE_FBV=y
BR2_PACKAGE_FBV_PNG=y
BR2_PACKAGE_FBV_JPEG=y

# =============================================================================
# SDL 1.2
# =============================================================================
BR2_PACKAGE_SDL=y
BR2_PACKAGE_SDL_FBCON=y
BR2_PACKAGE_SDL_GFX=y
BR2_PACKAGE_SDL_IMAGE=y
BR2_PACKAGE_SDL_IMAGE_BMP=y
BR2_PACKAGE_SDL_IMAGE_JPEG=y
BR2_PACKAGE_SDL_IMAGE_PNG=y
BR2_PACKAGE_SDL_SOUND=y
BR2_PACKAGE_SDL_TTF=y
BR2_PACKAGE_SDL12_COMPAT=y

# =============================================================================
# SDL 2
# =============================================================================
BR2_PACKAGE_SDL2=y
BR2_PACKAGE_SDL2_OPENGLES=y
BR2_PACKAGE_SDL2_KMSDRM=y
BR2_PACKAGE_SDL2_WAYLAND=y
BR2_PACKAGE_SDL2_GFX=y
BR2_PACKAGE_SDL2_IMAGE=y
BR2_PACKAGE_SDL2_MIXER=y
BR2_PACKAGE_SDL2_NET=y
BR2_PACKAGE_SDL2_TTF=y

# Wayland stack required by SDL2 wayland backend in 32-bit runtime.
BR2_PACKAGE_WAYLAND=y

# =============================================================================
# System - Core
# =============================================================================
BR2_PACKAGE_DBUS=y
BR2_PACKAGE_EUDEV=y
BR2_PACKAGE_EUDEV_MODULE_LOADING=y
BR2_PACKAGE_EUDEV_RULES_GEN=y
BR2_PACKAGE_EUDEV_ENABLE_HWDB=y
BR2_PACKAGE_EVTEST=y
BR2_PACKAGE_KBD=y
BR2_PACKAGE_TZDATA=y

# =============================================================================
# System - Crypto/Security
# =============================================================================
BR2_PACKAGE_CRYPTSETUP=y
BR2_PACKAGE_LUKSMETA=y
BR2_PACKAGE_CA_CERTIFICATES=y
BR2_PACKAGE_GNUTLS=y
BR2_PACKAGE_LIBARGON2=y
BR2_PACKAGE_LIBASSUAN=y
BR2_PACKAGE_LIBGPG_ERROR=y
BR2_PACKAGE_LIBGPGME=y
BR2_PACKAGE_LIBSODIUM=y
BR2_PACKAGE_LIBSODIUM_FULL=y
BR2_PACKAGE_LIBXCRYPT=y
BR2_PACKAGE_NETTLE=y
BR2_PACKAGE_OPENSSL_FORCE_LIBOPENSSL=y
BR2_PACKAGE_OPENSSL=y
BR2_PACKAGE_LIBOPENSSL=y
BR2_PACKAGE_LIBOPENSSL_BIN=y
BR2_PACKAGE_LIBOPENSSL_ENABLE_CHACHA=y
BR2_PACKAGE_LIBOPENSSL_ENABLE_RC2=y
BR2_PACKAGE_LIBOPENSSL_ENABLE_RC4=y
BR2_PACKAGE_LIBOPENSSL_ENABLE_MD2=y
BR2_PACKAGE_LIBOPENSSL_ENABLE_MD4=y
BR2_PACKAGE_LIBOPENSSL_ENABLE_MDC2=y
BR2_PACKAGE_LIBOPENSSL_ENABLE_BLAKE2=y
BR2_PACKAGE_LIBOPENSSL_ENABLE_IDEA=y
BR2_PACKAGE_LIBOPENSSL_ENABLE_SEED=y
BR2_PACKAGE_LIBOPENSSL_ENABLE_DES=y
BR2_PACKAGE_LIBOPENSSL_ENABLE_RMD160=y
BR2_PACKAGE_LIBOPENSSL_ENABLE_WHIRLPOOL=y
BR2_PACKAGE_LIBOPENSSL_ENABLE_BLOWFISH=y
BR2_PACKAGE_LIBOPENSSL_ENABLE_SSL=y
BR2_PACKAGE_LIBOPENSSL_ENABLE_SSL3=y
BR2_PACKAGE_LIBOPENSSL_ENABLE_WEAK_SSL=y
BR2_PACKAGE_LIBOPENSSL_ENABLE_PSK=y
BR2_PACKAGE_LIBOPENSSL_ENABLE_CAST=y
BR2_PACKAGE_LIBOPENSSL_UNSECURE=y
BR2_PACKAGE_LIBOPENSSL_DYNAMIC_ENGINE=y
BR2_PACKAGE_LIBOPENSSL_ENABLE_COMP=y
BR2_PACKAGE_GNUPG=y
BR2_PACKAGE_GNUPG_AES=y
BR2_PACKAGE_GNUPG_RSA=y
BR2_PACKAGE_GNUPG_GPGV=y
BR2_PACKAGE_GNUPG_GPGSPLIT=y
BR2_PACKAGE_GNUPG2_DEPENDS=y

# =============================================================================
# System - Storage/Filesystems
# =============================================================================
BR2_PACKAGE_LVM2=y
BR2_PACKAGE_LVM2_STANDARD_INSTALL=y
BR2_PACKAGE_MDADM=y
BR2_PACKAGE_LIBFUSE3=y
BR2_PACKAGE_LIBLOCKFILE=y
BR2_PACKAGE_PHYSFS=y
BR2_PACKAGE_LOCKFILE_PROGS=y

# =============================================================================
# System - Compression
# =============================================================================
BR2_PACKAGE_LIBARCHIVE=y
BR2_PACKAGE_LIBARCHIVE_BSDTAR=y
BR2_PACKAGE_LIBARCHIVE_BSDCPIO=y
BR2_PACKAGE_LIBARCHIVE_BSDCAT=y
BR2_PACKAGE_LIBZIP=y
BR2_PACKAGE_LZ4=y
BR2_PACKAGE_LZO=y
BR2_PACKAGE_ZLIB=y
BR2_PACKAGE_LIBZLIB=y

# =============================================================================
# System - Database
# =============================================================================
BR2_PACKAGE_SQLITE=y

# =============================================================================
# Hardware/Input
# =============================================================================
BR2_PACKAGE_HIDAPI=y
BR2_PACKAGE_JITTERENTROPY_LIBRARY=y
BR2_PACKAGE_LIBAIO=y
BR2_PACKAGE_LIBCEC=y
BR2_PACKAGE_LIBGUDEV=y
BR2_PACKAGE_LIBSERIALPORT=y
BR2_PACKAGE_LIBUSB=y
BR2_PACKAGE_LIBUSB_COMPAT=y
BR2_PACKAGE_LIBV4L=y
BR2_PACKAGE_LIBEVDEV=y
BR2_PACKAGE_READ_EDID=y
BR2_PACKAGE_EDID_DECODE=y
BR2_PACKAGE_RNG_TOOLS=y
BR2_PACKAGE_RNG_TOOLS_JITTERENTROPY_LIBRARY=y
BR2_PACKAGE_LIBPORTMIDI=y

# =============================================================================
# Data Formats - JSON/XML/YAML
# =============================================================================
BR2_PACKAGE_EXPAT=y
BR2_PACKAGE_JANSSON=y
BR2_PACKAGE_JOSE=y
BR2_PACKAGE_JSON_C=y
BR2_PACKAGE_JSON_FOR_MODERN_CPP=y
BR2_PACKAGE_LIBXML2=y
BR2_PACKAGE_LIBYAML=y
BR2_PACKAGE_RAPIDJSON=y
BR2_PACKAGE_TINYXML2=y

# =============================================================================
# Networking
# =============================================================================
BR2_PACKAGE_ENET=y
BR2_PACKAGE_LIBCURL=y
BR2_PACKAGE_LIBCURL_CURL=y
BR2_PACKAGE_LIBCURL_PROXY_SUPPORT=y
BR2_PACKAGE_LIBCURL_COOKIES_SUPPORT=y
BR2_PACKAGE_LIBCURL_EXTRA_PROTOCOLS_FEATURES=y
BR2_PACKAGE_LIBCURL_OPENSSL=y
BR2_PACKAGE_LIBMINIUPNPC=y
BR2_PACKAGE_LIBNL=y
BR2_PACKAGE_LIBPCAP=y
BR2_PACKAGE_LIBTIRPC=y
BR2_PACKAGE_NGHTTP2=y
BR2_PACKAGE_RTMPDUMP=y
BR2_PACKAGE_SLIRP=y
BR2_PACKAGE_LIBENET=y

# =============================================================================
# Development Libraries
# =============================================================================
BR2_PACKAGE_BOOST=y
BR2_PACKAGE_BOOST_ATOMIC=y
BR2_PACKAGE_BOOST_DATE_TIME=y
BR2_PACKAGE_BOOST_FILESYSTEM=y
BR2_PACKAGE_BOOST_IOSTREAMS=y
BR2_PACKAGE_BOOST_NOWIDE=y
BR2_PACKAGE_BOOST_PROGRAM_OPTIONS=y
BR2_PACKAGE_BOOST_SYSTEM=y
BR2_PACKAGE_CMOCKA=y
BR2_PACKAGE_GLM=y
BR2_PACKAGE_GMP=y
BR2_PACKAGE_GOBJECT_INTROSPECTION=y
BR2_PACKAGE_LIBCAP=y
BR2_PACKAGE_LIBCAP_NG=y
BR2_PACKAGE_LIBDAEMON=y
BR2_PACKAGE_LIBEVENT=y
BR2_PACKAGE_LIBFFI=y
BR2_PACKAGE_LIBGLIB2=y
BR2_PACKAGE_LIBPLATFORM=y
BR2_PACKAGE_LIBPTHREAD_STUBS=y
BR2_PACKAGE_LIBTALLOC=y
BR2_PACKAGE_LIBTASN1=y
BR2_PACKAGE_LINUX_PAM=y
BR2_PACKAGE_FMT=y
BR2_PACKAGE_ICU=y
BR2_PACKAGE_ICU_CUSTOM_DATA_PATH=""
BR2_PACKAGE_LIBFRIBIDI=y
BR2_PACKAGE_LIBUNISTRING=y
BR2_PACKAGE_IIR=y

# =============================================================================
# Text/Terminal
# =============================================================================
BR2_PACKAGE_NCURSES=y
BR2_PACKAGE_NCURSES_WCHAR=y
BR2_PACKAGE_NCURSES_TARGET_PROGS=y
BR2_PACKAGE_NCURSES_ADDITIONAL_TERMINFO=""
BR2_PACKAGE_PCRE=y
BR2_PACKAGE_PCRE2=y
BR2_PACKAGE_POPT=y
BR2_PACKAGE_READLINE=y
BR2_PACKAGE_BC=y
BR2_PACKAGE_DIALOG=y

# =============================================================================
# Python
# =============================================================================
BR2_PACKAGE_PYTHON3=y
BR2_PACKAGE_PYTHON3_PY_PYC=y
BR2_PACKAGE_PYTHON3_BZIP2=y
BR2_PACKAGE_PYTHON3_SSL=y
BR2_PACKAGE_PYTHON3_UNICODEDATA=y
BR2_PACKAGE_PYTHON3_PYEXPAT=y
BR2_PACKAGE_PYTHON3_XZ=y
BR2_PACKAGE_PYTHON3_ZLIB=y
BR2_PACKAGE_PYTHON_CERTIFI=y
BR2_PACKAGE_PYTHON_CHARSET_NORMALIZER=y
BR2_PACKAGE_PYTHON_EVDEV=y
BR2_PACKAGE_PYTHON_FUTURE=y
BR2_PACKAGE_PYTHON_GOBJECT=y
BR2_PACKAGE_PYTHON_HTTPLIB2=y
BR2_PACKAGE_PYTHON_IDNA=y
BR2_PACKAGE_PYTHON_NUMPY=y
BR2_PACKAGE_PYTHON_PILLOW=y
BR2_PACKAGE_PYTHON_PROTOBUF=y
BR2_PACKAGE_PYTHON_PSUTIL=y
BR2_PACKAGE_PYTHON_PYPARSING=y
BR2_PACKAGE_PYTHON_PYUDEV=y
BR2_PACKAGE_PYTHON_PYYAML=y
BR2_PACKAGE_PYTHON_REQUESTS=y
BR2_PACKAGE_PYTHON_RUAMEL_YAML=y
BR2_PACKAGE_PYTHON_SETUPTOOLS=y
BR2_PACKAGE_PYTHON_SIX=y
BR2_PACKAGE_PYTHON_TOML=y
BR2_PACKAGE_PYTHON_URLLIB3=y
BR2_PACKAGE_PYTHON_HIDAPI=y
BR2_PACKAGE_DBUS_PYTHON=y

# =============================================================================
# Scripting Languages
# =============================================================================
BR2_PACKAGE_JANET=y
BR2_PACKAGE_JIMTCL=y
BR2_PACKAGE_LPEG=y

# =============================================================================
# Fonts
# =============================================================================
BR2_PACKAGE_NANUM_FONT=y
BR2_PACKAGE_NOTO_CJK_FONTS=y

# =============================================================================
# Gaming/Emulation Support Libraries
# =============================================================================
BR2_PACKAGE_GL4ES=y
BR2_PACKAGE_LIBCAPSIMAGE=y

# =============================================================================
# X11/Windowing runtime (required by Wine/PortMaster 32-bit userspace)
# =============================================================================
BR2_PACKAGE_XORG7=y
BR2_PACKAGE_XLIB_LIBX11=y
BR2_PACKAGE_XLIB_LIBXEXT=y
BR2_PACKAGE_XLIB_LIBXCOMPOSITE=y
BR2_PACKAGE_XLIB_LIBXXF86VM=y
BR2_PACKAGE_XLIB_LIBXDAMAGE=y
BR2_PACKAGE_XLIB_LIBXFIXES=y
BR2_PACKAGE_XLIB_LIBXCURSOR=y
BR2_PACKAGE_XLIB_LIBXI=y
BR2_PACKAGE_XLIB_LIBXRANDR=y
BR2_PACKAGE_XLIB_LIBXRENDER=y
BR2_PACKAGE_LIBXCB=y
BR2_PACKAGE_LIBXKBCOMMON=y
BR2_PACKAGE_CUPS=y
BR2_PACKAGE_VULKAN_HEADERS=y
BR2_PACKAGE_VULKAN_LOADER=y
BR2_PACKAGE_MESA3D_OPENGL_GLX=y
BR2_PACKAGE_XUTIL_UTIL_MACROS=y

# =============================================================================
# Qt Support (headers/features detection)
# =============================================================================
BR2_PACKAGE_QT5_GL_AVAILABLE=y
BR2_PACKAGE_QT5_JSCORE_AVAILABLE=y
BR2_PACKAGE_QT6_GL_SUPPORTS=y

# from file batocera-rk3568_armhf_libs.packages
# batocera-rk3568_armhf_libs.packages
# 32-bit library package set for RK3568 / PortMaster compatibility
#
# Keep this aligned with the known-good aarch64+armhf stack already used by
# rk3588. If rk3568-specific deltas are needed later, append overrides below.


### from board file ###
# batocera-rk3568_armhf_libs.board
# 32-bit armhf library build for Rockchip RK3568 boards
# Produces libraries to be installed at /lib32 on the 64-bit image


# Target definition - 32-bit ARM
BR2_arm=y
BR2_ARM_EABIHF=y
BR2_cortex_a53=y
BR2_ARM_FPU_NEON_FP_ARMV8=y
BR2_PACKAGE_BATOCERA_TARGET_RK3568=y
# Keep Kconfig cpu on a53 (valid in this Buildroot arm32 setup), but tune
# package CFLAGS for the actual SoC little cores.
BR2_TARGET_OPTIMIZATION="-pipe -fsigned-char -mcpu=cortex-a55 -mtune=cortex-a55"
BR2_TARGET_GENERIC_GETTY_BAUDRATE_115200=y
BR2_GLOBAL_PATCH_DIR="$(BR2_EXTERNAL_BATOCERA_PATH)/board/batocera/patches $(BR2_EXTERNAL_BATOCERA_PATH)/board/batocera/rockchip/patches $(BR2_EXTERNAL_BATOCERA_PATH)/board/batocera/rockchip/rk3568/patches"

# Kernel headers matching the rk3568 base build
BR2_KERNEL_HEADERS_6_18=y

# Enable C++ standard library (needed for many libs)
BR2_INSTALL_LIBSTDCPP=y

# GPU - Mesa with Panfrost for 32-bit userspace
BR2_PACKAGE_MESA3D=y
BR2_PACKAGE_MESA3D_LLVM=y
BR2_PACKAGE_MESA3D_GALLIUM_DRIVER_PANFROST=y
BR2_PACKAGE_MESA3D_OPENGL_EGL=y
BR2_PACKAGE_MESA3D_OPENGL_ES=y

# Reuse the validated armhf package stack used for other panfrost boards
```
