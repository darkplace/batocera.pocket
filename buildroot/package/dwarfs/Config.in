## buildroot/package/dwarfs/Config.in
```kconfig
config BR2_PACKAGE_DWARFS_ARCH_SUPPORTS
	bool
	default y if ((BR2_arm || BR2_armeb) && BR2_ARM_CPU_HAS_ARM)
	default y if (BR2_aarch64 || BR2_aarch64_be)
	default y if BR2_i386
	default y if BR2_mips
	default y if BR2_mipsel
	default y if BR2_powerpc
	default y if BR2_x86_64
	default y if BR2_riscv

config BR2_PACKAGE_DWARFS
	bool "dwarfs"
	depends on !BR2_STATIC_LIBS
	depends on BR2_HOST_CMAKE_AT_LEAST_3_28
	depends on BR2_INSTALL_LIBSTDCPP
	depends on BR2_PACKAGE_DWARFS_ARCH_SUPPORTS
	depends on BR2_TOOLCHAIN_GCC_AT_LEAST_10 # C++20
	depends on BR2_TOOLCHAIN_HAS_THREADS
	depends on BR2_TOOLCHAIN_SUPPORTS_ALWAYS_LOCKFREE_ATOMIC_INTS # boost-thread, boost-filesystem
	depends on !BR2_TOOLCHAIN_HAS_GCC_BUG_64735 # boost-context, boost-thread
	depends on BR2_USE_MMU # libfuse3
	depends on BR2_USE_WCHAR # fmt, boost
	select BR2_PACKAGE_BOOST
	select BR2_PACKAGE_BOOST_CHRONO
	select BR2_PACKAGE_BOOST_CONTEXT
	select BR2_PACKAGE_BOOST_FILESYSTEM
	select BR2_PACKAGE_BOOST_PROGRAM_OPTIONS
	select BR2_PACKAGE_BOOST_REGEX
	select BR2_PACKAGE_BOOST_THREAD
	select BR2_PACKAGE_DOUBLE_CONVERSION
	select BR2_PACKAGE_FMT
	select BR2_PACKAGE_GLOG
	select BR2_PACKAGE_LIBARCHIVE
	select BR2_PACKAGE_LIBEVENT
	select BR2_PACKAGE_LIBFUSE3
	select BR2_PACKAGE_OPENSSL
	select BR2_PACKAGE_PARALLEL_HASHMAP
	select BR2_PACKAGE_RANGE_V3
	select BR2_PACKAGE_UTFCPP
	select BR2_PACKAGE_XXHASH
	select BR2_PACKAGE_ZSTD
	help
	  DwarFS is a compressed read-only filesystem and toolset.

	  This package builds the core libraries, the `mkdwarfs`,
	  `dwarfsck`, and `dwarfsextract` tools, plus the FUSE3 mount
	  binary.

	  https://github.com/mhx/dwarfs

comment "dwarfs needs a toolchain w/ dynamic library, C++, threads, wchar, gcc >= 10"
	depends on BR2_HOST_CMAKE_AT_LEAST_3_28
	depends on BR2_PACKAGE_DWARFS_ARCH_SUPPORTS
	depends on BR2_TOOLCHAIN_SUPPORTS_ALWAYS_LOCKFREE_ATOMIC_INTS
	depends on !BR2_TOOLCHAIN_HAS_GCC_BUG_64735
	depends on BR2_USE_MMU
	depends on BR2_STATIC_LIBS || !BR2_INSTALL_LIBSTDCPP || \
		!BR2_TOOLCHAIN_GCC_AT_LEAST_10 || !BR2_TOOLCHAIN_HAS_THREADS || \
		!BR2_USE_WCHAR

comment "dwarfs needs host cmake >= 3.28"
	depends on !BR2_HOST_CMAKE_AT_LEAST_3_28
	depends on !BR2_STATIC_LIBS
	depends on BR2_INSTALL_LIBSTDCPP
	depends on BR2_PACKAGE_DWARFS_ARCH_SUPPORTS
	depends on BR2_TOOLCHAIN_GCC_AT_LEAST_10
	depends on BR2_TOOLCHAIN_HAS_THREADS
	depends on BR2_TOOLCHAIN_SUPPORTS_ALWAYS_LOCKFREE_ATOMIC_INTS
	depends on !BR2_TOOLCHAIN_HAS_GCC_BUG_64735
	depends on BR2_USE_MMU
	depends on BR2_USE_WCHAR

comment "dwarfs needs an architecture supported by boost-context"
	depends on !BR2_PACKAGE_DWARFS_ARCH_SUPPORTS
	depends on !BR2_STATIC_LIBS
	depends on BR2_HOST_CMAKE_AT_LEAST_3_28
	depends on BR2_INSTALL_LIBSTDCPP
	depends on BR2_TOOLCHAIN_GCC_AT_LEAST_10
	depends on BR2_TOOLCHAIN_HAS_THREADS
	depends on BR2_TOOLCHAIN_SUPPORTS_ALWAYS_LOCKFREE_ATOMIC_INTS
	depends on !BR2_TOOLCHAIN_HAS_GCC_BUG_64735
	depends on BR2_USE_MMU
	depends on BR2_USE_WCHAR

comment "dwarfs needs a toolchain with lockfree atomic ints"
	depends on !BR2_TOOLCHAIN_SUPPORTS_ALWAYS_LOCKFREE_ATOMIC_INTS
	depends on !BR2_STATIC_LIBS
	depends on BR2_HOST_CMAKE_AT_LEAST_3_28
	depends on BR2_INSTALL_LIBSTDCPP
	depends on BR2_PACKAGE_DWARFS_ARCH_SUPPORTS
	depends on BR2_TOOLCHAIN_GCC_AT_LEAST_10
	depends on BR2_TOOLCHAIN_HAS_THREADS
	depends on !BR2_TOOLCHAIN_HAS_GCC_BUG_64735
	depends on BR2_USE_MMU
	depends on BR2_USE_WCHAR

comment "dwarfs needs a toolchain not affected by GCC bug 64735"
	depends on BR2_TOOLCHAIN_HAS_GCC_BUG_64735
	depends on !BR2_STATIC_LIBS
	depends on BR2_HOST_CMAKE_AT_LEAST_3_28
	depends on BR2_INSTALL_LIBSTDCPP
	depends on BR2_PACKAGE_DWARFS_ARCH_SUPPORTS
	depends on BR2_TOOLCHAIN_GCC_AT_LEAST_10
	depends on BR2_TOOLCHAIN_HAS_THREADS
	depends on BR2_TOOLCHAIN_SUPPORTS_ALWAYS_LOCKFREE_ATOMIC_INTS
	depends on BR2_USE_MMU
	depends on BR2_USE_WCHAR
```

## buildroot/package/parallel-hashmap/Config.in
```kconfig
config BR2_PACKAGE_PARALLEL_HASHMAP
	bool "parallel-hashmap"
	depends on BR2_INSTALL_LIBSTDCPP
	depends on BR2_TOOLCHAIN_GCC_AT_LEAST_4_8 # C++11
	help
	  Parallel Hashmap is a header-only C++ hash map and btree
	  library.

	  https://github.com/greg7mdp/parallel-hashmap

comment "parallel-hashmap needs a toolchain w/ C++, gcc >= 4.8"
	depends on !BR2_INSTALL_LIBSTDCPP || !BR2_TOOLCHAIN_GCC_AT_LEAST_4_8
```

## buildroot/package/range-v3/Config.in
```kconfig
config BR2_PACKAGE_RANGE_V3
	bool "range-v3"
	depends on BR2_INSTALL_LIBSTDCPP
	depends on BR2_TOOLCHAIN_GCC_AT_LEAST_5 # C++14
	help
	  Range library for C++14 and later.

	  https://github.com/ericniebler/range-v3

comment "range-v3 needs a toolchain w/ C++, gcc >= 5"
	depends on !BR2_INSTALL_LIBSTDCPP || !BR2_TOOLCHAIN_GCC_AT_LEAST_5
```

## buildroot/package/utfcpp/Config.in
```kconfig
config BR2_PACKAGE_UTFCPP
	bool "utfcpp"
	depends on BR2_INSTALL_LIBSTDCPP
	help
	  UTF8-CPP is a header-only C++ library for working with UTF-8.

	  https://github.com/nemtrif/utfcpp

comment "utfcpp needs a toolchain w/ C++"
	depends on !BR2_INSTALL_LIBSTDCPP
```

## buildroot/package/virglrenderer/Config.in
```kconfig
comment "virglrenderer needs a toolchain w/ threads, dynamic library, OpenGL/EGL, and GBM"
	depends on !BR2_STATIC_LIBS
	depends on BR2_TOOLCHAIN_HAS_THREADS
	depends on BR2_PACKAGE_HAS_LIBGL
	depends on BR2_PACKAGE_HAS_LIBEGL
	depends on BR2_PACKAGE_HAS_LIBGBM

config BR2_PACKAGE_VIRGLRENDERER
	bool "virglrenderer"
	depends on !BR2_STATIC_LIBS
	depends on BR2_TOOLCHAIN_HAS_THREADS
	depends on BR2_PACKAGE_HAS_LIBGL
	depends on BR2_PACKAGE_HAS_LIBEGL
	depends on BR2_PACKAGE_HAS_LIBGBM
	select BR2_PACKAGE_LIBDRM
	select BR2_PACKAGE_LIBEPOXY
	help
	  Virglrenderer is the host-side renderer used by QEMU's
	  virtio-gpu accelerated 3D path.

	  https://gitlab.freedesktop.org/virgl/virglrenderer
```

## buildroot/package/xdg-desktop-portal-gtk/Config.in
```kconfig
config BR2_PACKAGE_XDG_DESKTOP_PORTAL_GTK
	bool "xdg-desktop-portal-gtk"
	depends on BR2_PACKAGE_XDG_DESKTOP_PORTAL
	depends on BR2_PACKAGE_LIBGTK3
	help
	  xdg-desktop-portal-gtk is a GTK backend for xdg-desktop-portal.
	  It provides interfaces such as FileChooser and AppChooser, used by
	  OpenURI flows in Flatpak apps.

	  https://github.com/flatpak/xdg-desktop-portal-gtk

comment "xdg-desktop-portal-gtk needs xdg-desktop-portal and libgtk3"
	depends on !BR2_PACKAGE_XDG_DESKTOP_PORTAL || !BR2_PACKAGE_LIBGTK3
```

## buildroot/package/xdg-desktop-portal-wlr/Config.in
```kconfig
config BR2_PACKAGE_XDG_DESKTOP_PORTAL_WLR
	bool "xdg-desktop-portal-wlr"
	depends on BR2_TOOLCHAIN_HAS_THREADS # wayland
	depends on BR2_USE_MMU # wayland
	depends on !BR2_STATIC_LIBS # wayland
	depends on BR2_PACKAGE_HAS_LIBGBM # gbm
	depends on BR2_PACKAGE_XDG_DESKTOP_PORTAL
	select BR2_PACKAGE_BASU
	select BR2_PACKAGE_INIH
	select BR2_PACKAGE_LIBDRM
	select BR2_PACKAGE_PIPEWIRE
	select BR2_PACKAGE_WAYLAND
	select BR2_PACKAGE_WAYLAND_PROTOCOLS
	help
	  xdg-desktop-portal-wlr is a wlroots backend for
	  xdg-desktop-portal.

	  https://github.com/emersion/xdg-desktop-portal-wlr

comment "xdg-desktop-portal-wlr needs a toolchain w/ threads, dynamic library, MMU and libgbm"
	depends on !BR2_TOOLCHAIN_HAS_THREADS || BR2_STATIC_LIBS || !BR2_USE_MMU || \
		!BR2_PACKAGE_HAS_LIBGBM

comment "xdg-desktop-portal-wlr needs xdg-desktop-portal"
	depends on BR2_TOOLCHAIN_HAS_THREADS
	depends on BR2_USE_MMU
	depends on !BR2_STATIC_LIBS
	depends on BR2_PACKAGE_HAS_LIBGBM
	depends on !BR2_PACKAGE_XDG_DESKTOP_PORTAL
```

## buildroot/package/xdg-desktop-portal/Config.in
```kconfig
config BR2_PACKAGE_XDG_DESKTOP_PORTAL
	bool "xdg-desktop-portal"
	depends on BR2_USE_WCHAR # gdk-pixbuf
	depends on BR2_TOOLCHAIN_HAS_THREADS # libglib2
	depends on BR2_USE_MMU # libglib2
	depends on !BR2_STATIC_LIBS # libfuse3
	select BR2_PACKAGE_GDK_PIXBUF
	select BR2_PACKAGE_JSON_GLIB
	select BR2_PACKAGE_LIBFUSE3
	select BR2_PACKAGE_LIBGLIB2
	select BR2_PACKAGE_PIPEWIRE
	help
	  xdg-desktop-portal provides a desktop integration service
	  used by sandboxed applications, including Flatpak apps.

	  https://github.com/flatpak/xdg-desktop-portal

comment "xdg-desktop-portal needs a toolchain w/ wchar, threads, dynamic library"
	depends on BR2_USE_MMU
	depends on !BR2_USE_WCHAR || !BR2_TOOLCHAIN_HAS_THREADS || BR2_STATIC_LIBS
```

## package/batocera/emulationstation/es-theme-carbon/Config.in
```kconfig
config BR2_PACKAGE_ES_THEME_CARBON
	bool "es-theme-carbon"
	help
	  EmulationStation theme Carbon (Batocera version).

	  https://github.com/suckbluefrog/es-theme-carbon
```

## package/batocera/emulators/86box/Config.in
```kconfig
config BR2_PACKAGE_86BOX
	bool "86box"
	depends on BR2_PACKAGE_BATOCERA_TARGET_X86_64_ANY
	select BR2_PACKAGE_BATOCERA_QT6
	select BR2_PACKAGE_BATOCERA_SDL2
	select BR2_PACKAGE_RTMIDI
	select BR2_PACKAGE_LIBSNDFILE
	select BR2_PACKAGE_SLIRP
	select BR2_PACKAGE_OPENAL
	select BR2_PACKAGE_XORG7
	select BR2_PACKAGE_LIBXKBCOMMON

	help
	  86Box IBM PC system emulator.

	  https://86box.net/
```

## package/batocera/emulators/citron/Config.in
```kconfig
config BR2_PACKAGE_CITRON
	bool "Citron (Nintendo Switch)"
	depends on BR2_aarch64
	help
	  Citron Nintendo Switch emulator (AppImage).

	  This package installs the Citron AppImage into /usr/share/citron
	  with a wrapper script in /usr/bin/citron.
```

## package/batocera/emulators/freej2me/Config.in
```kconfig
config BR2_PACKAGE_FREEJ2ME
	bool "freej2me"
	depends on BR2_PACKAGE_HOST_OPENJDK_BIN_ARCH_SUPPORTS
	depends on BR2_PACKAGE_OPENJDK_ARCH_SUPPORTS
	depends on !BR2_SOFT_FLOAT
	depends on !BR2_STATIC_LIBS
	depends on BR2_INSTALL_LIBSTDCPP
	depends on BR2_TOOLCHAIN_HAS_THREADS
	depends on BR2_TOOLCHAIN_GCC_AT_LEAST_4_9
	depends on BR2_HOST_GCC_AT_LEAST_4_9
	depends on BR2_TOOLCHAIN_USES_GLIBC
	depends on BR2_USE_MMU
	depends on BR2_PACKAGE_XORG7
	select BR2_PACKAGE_OPENJDK
	help
	  FreeJ2ME standalone Java 2 Micro Edition emulator.

	  https://github.com/hex007/freej2me
```

## package/batocera/emulators/gmu/Config.in
```kconfig
config BR2_PACKAGE_GMU
	bool "gmu"
	select BR2_PACKAGE_SDL2
	select BR2_PACKAGE_SDL2_GFX
	select BR2_PACKAGE_SDL2_IMAGE
	select BR2_PACKAGE_SQLITE
	select BR2_PACKAGE_MPG123
	select BR2_PACKAGE_TREMOR
	select BR2_PACKAGE_FLAC
	select BR2_PACKAGE_OPUS
	select BR2_PACKAGE_OPUSFILE
	select BR2_PACKAGE_SPEEX
	select BR2_PACKAGE_NCURSES
	select BR2_PACKAGE_NCURSES_WCHAR
	help
	  Gmu Music Player.

	  https://github.com/jhe2/gmu
```

## package/batocera/emulators/gopher64/Config.in
```kconfig
config BR2_PACKAGE_GOPHER64
    bool "gopher64"
    depends on BR2_x86_64 || BR2_aarch64
    depends on BR2_PACKAGE_HOST_RUSTC_TARGET_ARCH_SUPPORTS
    select BR2_PACKAGE_HOST_RUSTC
    select BR2_PACKAGE_HOST_CLANG
    select BR2_PACKAGE_HOST_CMAKE
    select BR2_PACKAGE_HOST_NINJA
    select BR2_PACKAGE_ALSA_LIB
    select BR2_PACKAGE_LIBDRM
    select BR2_PACKAGE_MESA3D
    select BR2_PACKAGE_VULKAN_LOADER
    help
      Gopher64 is a Nintendo 64 emulator with Vulkan rendering and a native
      Linux frontend.

      https://github.com/gopher64/gopher64
```

## package/batocera/emulators/nanoboyadvance/Config.in
```kconfig
config BR2_PACKAGE_NANOBOYADVANCE
    bool "nanoboyadvance"
    depends on BR2_INSTALL_LIBSTDCPP
    depends on BR2_PACKAGE_XORG7
    depends on BR2_PACKAGE_HAS_LIBGL
    select BR2_PACKAGE_BATOCERA_SDL2
    select BR2_PACKAGE_LIBGLEW
    select BR2_PACKAGE_LIBGLU
    help
      NanoBoyAdvance is a cycle-accurate Game Boy Advance emulator.

      https://github.com/nba-emu/NanoBoyAdvance

comment "nanoboyadvance needs X.org, OpenGL, and a toolchain w/ C++"
    depends on !BR2_INSTALL_LIBSTDCPP || !BR2_PACKAGE_XORG7 || !BR2_PACKAGE_HAS_LIBGL
```

## package/batocera/emulators/retroarch/libretro/libretro-azahar/Config.in
```kconfig
config BR2_PACKAGE_LIBRETRO_AZAHAR
    bool "libretro-azahar"
    depends on BR2_INSTALL_LIBSTDCPP
    depends on BR2_PACKAGE_HAS_LIBGL
    help
      Azahar libretro Nintendo 3DS core.

      https://github.com/azahar-emu/azahar

comment "LIBRETRO_AZAHAR needs a toolchain w/ C++ and OpenGL"
    depends on !BR2_INSTALL_LIBSTDCPP || !BR2_PACKAGE_HAS_LIBGL
```

## package/batocera/emulators/retroarch/libretro/libretro-mame2010/Config.in
```kconfig
config BR2_PACKAGE_LIBRETRO_MAME2010
	bool "libretro-mame2010"
	help
	  A port of MAME 0.139 to libretro

	  https://github.com/libretro/mame2010-libretro
```

## package/batocera/emulators/retroarch/libretro/libretro-skyemu/Config.in
```kconfig
config BR2_PACKAGE_LIBRETRO_SKYEMU
    bool "libretro-skyemu"
    help
      A libretro core for Game Boy, Game Boy Color, Game Boy Advance,
      and Nintendo DS built from SkyEmu.

      https://github.com/skylersaleh/SkyEmu
```

## package/batocera/emulators/skyemu/Config.in
```kconfig
config BR2_PACKAGE_SKYEMU
    bool "skyemu"
    depends on BR2_INSTALL_LIBSTDCPP
    depends on BR2_PACKAGE_XORG7
    depends on BR2_PACKAGE_HAS_LIBGL
    select BR2_PACKAGE_BATOCERA_SDL2
    select BR2_PACKAGE_LIBCURL_CURL
    select BR2_PACKAGE_OPENSSL
    select BR2_PACKAGE_ALSA_LIB
    select BR2_PACKAGE_XLIB_LIBX11
    select BR2_PACKAGE_XLIB_LIBXI
    select BR2_PACKAGE_XLIB_LIBXCURSOR
    help
      SkyEmu is a Game Boy, Game Boy Color, Game Boy Advance, and Nintendo DS
      emulator.

      https://github.com/skylersaleh/SkyEmu

comment "skyemu needs X.org, OpenGL, and a toolchain w/ C++"
    depends on !BR2_INSTALL_LIBSTDCPP || !BR2_PACKAGE_XORG7 || !BR2_PACKAGE_HAS_LIBGL
```

## package/batocera/emulators/touchhle/Config.in
```kconfig
config BR2_PACKAGE_TOUCHHLE
	bool "touchHLE"
	depends on BR2_PACKAGE_BATOCERA_TARGET_X86_64_ANY || \
		   BR2_PACKAGE_BATOCERA_TARGET_QCS6490 || \
		   BR2_PACKAGE_BATOCERA_TARGET_SM8250 || \
		   BR2_PACKAGE_BATOCERA_TARGET_SM8550 || \
		   BR2_PACKAGE_BATOCERA_TARGET_RK3568
	depends on BR2_PACKAGE_HOST_RUSTC_TARGET_ARCH_SUPPORTS
	select BR2_PACKAGE_HOST_RUSTC
	select BR2_PACKAGE_HOST_CMAKE
	select BR2_PACKAGE_BOOST
	select BR2_PACKAGE_BATOCERA_SDL2
	select BR2_PACKAGE_OPENAL

	help
	  touchHLE is a high-level emulator for early iPhone OS apps.

	  https://github.com/touchHLE/touchHLE
```

## package/batocera/emulators/yabasanshiro/Config.in
```kconfig
config BR2_PACKAGE_YABASANSHIRO
	bool "yabasanshiro"
	depends on BR2_aarch64
	depends on BR2_PACKAGE_BATOCERA_GLES3
	select BR2_PACKAGE_BOOST
	select BR2_PACKAGE_BOOST_DATE_TIME
	select BR2_PACKAGE_BOOST_FILESYSTEM
	select BR2_PACKAGE_BOOST_LOCALE
	select BR2_PACKAGE_BOOST_SYSTEM
	select BR2_PACKAGE_JSON_FOR_MODERN_CPP
	select BR2_PACKAGE_LIBCHDR
	select BR2_PACKAGE_LIBPNG
	select BR2_PACKAGE_OPENAL
	select BR2_PACKAGE_SDL2
	select BR2_PACKAGE_SDL2_OPENGLES if BR2_PACKAGE_HAS_LIBGLES
	select BR2_PACKAGE_ZLIB
	help
	  Standalone Yaba Sanshiro Sega Saturn emulator using the RetroArena
	  frontend and DevMiyax SH2 dynarec.

	  https://github.com/sydarn/yabause
```

## package/batocera/libraries/flac8-compat/Config.in
```kconfig
config BR2_PACKAGE_FLAC8_COMPAT
	bool "flac8-compat"
	select BR2_PACKAGE_LIBOGG
	help
	  Installs legacy libFLAC.so.8 runtime compatibility library.
	  Intended for older prebuilt binaries (e.g. some PortMaster ports)
	  that still depend on FLAC SONAME 8.
```
