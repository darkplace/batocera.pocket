## package/batocera/libraries/gtk-vnc/Config.in
```kconfig
config BR2_PACKAGE_GTK_VNC
	bool "gtk-vnc"
	depends on !BR2_STATIC_LIBS
	depends on BR2_USE_MMU
	depends on BR2_USE_WCHAR
	depends on BR2_TOOLCHAIN_HAS_THREADS
	depends on BR2_PACKAGE_GOBJECT_INTROSPECTION_ARCH_SUPPORTS
	depends on BR2_TOOLCHAIN_USES_GLIBC
	select BR2_PACKAGE_GOBJECT_INTROSPECTION
	select BR2_PACKAGE_GNUTLS
	select BR2_PACKAGE_LIBGCRYPT
	select BR2_PACKAGE_LIBGTK3
	select BR2_PACKAGE_LIBGTK3_X11
	select BR2_PACKAGE_ZLIB
	help
	  GTK VNC viewer widget and introspection bindings.

	  https://wiki.gnome.org/Projects/gtk-vnc

comment "gtk-vnc needs a glibc toolchain, wchar, threads, dynamic library"
	depends on BR2_USE_MMU
	depends on BR2_PACKAGE_GOBJECT_INTROSPECTION_ARCH_SUPPORTS
	depends on BR2_STATIC_LIBS || !BR2_USE_WCHAR || !BR2_TOOLCHAIN_HAS_THREADS || !BR2_TOOLCHAIN_USES_GLIBC
```

## package/batocera/libraries/libcurl3-compat/Config.in
```kconfig
config BR2_PACKAGE_LIBCURL3_COMPAT
	bool "libcurl3-compat"
	depends on BR2_i386
	select BR2_PACKAGE_LIBCURL
	help
	  Installs legacy libcurl SONAME compatibility link:
	  libcurl.so.3 -> libcurl.so.4
	  Intended for older prebuilt 32-bit binaries.
```

## package/batocera/libraries/libgbinder/Config.in
```kconfig
config BR2_PACKAGE_LIBGBINDER
	bool "libgbinder"
	select BR2_PACKAGE_LIBGLIB2
	select BR2_PACKAGE_LIBGLIBUTIL
	help
	  Binder protocol helper library used by Waydroid.

	  https://github.com/waydroid/libgbinder
```
