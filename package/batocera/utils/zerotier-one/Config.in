## package/batocera/utils/zerotier-one/Config.in
```kconfig
config BR2_PACKAGE_ZEROTIER_ONE
	bool "zerotier-one"
	depends on BR2_INSTALL_LIBSTDCPP
	depends on BR2_TOOLCHAIN_HAS_THREADS
	depends on BR2_USE_MMU
	help
	  ZeroTier virtual networking service and CLI.

comment "zerotier-one needs a toolchain w/ C++, threads, MMU"
	depends on !BR2_INSTALL_LIBSTDCPP || !BR2_TOOLCHAIN_HAS_THREADS || !BR2_USE_MMU
```

## package/batocera/wine/dxvk/Config.in
```kconfig
config BR2_PACKAGE_DXVK
	bool "dxvk"
	# Wine unconditionally builds shared libraries
	depends on !BR2_STATIC_LIBS
	depends on BR2_PACKAGE_SPIRV_HEADERS
	help
      DXVK is a Vulkan-based translation layer for Direct3D 8/9/10/11
	  which allows running 3D applications on Linux using Wine.

	  https://github.com/doitsujin/dxvk

comment "dxvk needs a toolchain w/ dynamic library"
	depends on BR2_STATIC_LIBS
```

## package/batocera/wine/lsfg-vk/Config.in
```kconfig
config BR2_PACKAGE_LSFG_VK
	bool "lsfg-vk"
	depends on BR2_x86_64 || BR2_aarch64
	help
	  Lossless Scaling Frame Generation Vulkan layer.
	  On aarch64 targets this builds the native layer for native Vulkan
	  AppImages and also installs the upstream x86_64 layer privately for
	  Wine/FEX. A user-provided Lossless.dll from a purchased Lossless
	  Scaling installation is still required at runtime.

	  https://github.com/PancakeTAS/lsfg-vk
```

## package/batocera/wine/mf/Config.in
```kconfig
config BR2_PACKAGE_MF
	bool "mf"
	# Wine unconditionally builds shared libraries
	depends on BR2_aarch64 || BR2_x86_64

	depends on !BR2_STATIC_LIBS
	depends on BR2_PACKAGE_SPIRV_HEADERS
	help
          MF
          A Media Foundation workaround for Wine.

          https://github.com/z0z0z/mf-install

comment "dxvk needs a toolchain w/ dynamic library"
	depends on BR2_STATIC_LIBS
```

## package/batocera/wine/wine-mono/Config.in
```kconfig
config BR2_PACKAGE_WINE_MONO
	bool "wine-mono"
      help
      Wine Mono for Wine.
```
