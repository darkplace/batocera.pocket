## package/batocera/libraries/rapidyaml/Config.in
```kconfig
config BR2_PACKAGE_RAPIDYAML
    bool "rapidyaml"
    help
      Rapid YAML library and ryml CMake package.

      https://github.com/biojppm/rapidyaml
```

## package/batocera/ports/opengoal/Config.in
```kconfig
config BR2_PACKAGE_OPENGOAL
	bool "opengoal"
	depends on BR2_aarch64 || BR2_x86_64
	depends on BR2_HOSTARCH = "x86_64"
	depends on BR2_TOOLCHAIN_USES_GLIBC
	depends on BR2_INSTALL_LIBSTDCPP
	depends on BR2_TOOLCHAIN_HAS_THREADS
	depends on BR2_USE_WCHAR
	depends on !BR2_STATIC_LIBS
	depends on BR2_USE_MMU
	depends on BR2_PACKAGE_PULSEAUDIO_HAS_ATOMIC
	select BR2_PACKAGE_BOX64 if BR2_aarch64
	select BR2_PACKAGE_ALSA_LIB
	select BR2_PACKAGE_ZLIB
	select BR2_PACKAGE_OPENSSL
	select BR2_PACKAGE_PULSEAUDIO
	help
	  OpenGOAL runtime, extractor, and compiler for the Jak and
	  Daxter series.

	  On aarch64 targets, this package builds the x86_64 Linux
	  OpenGOAL binaries from source and runs them through Box64.
	  Requires a user-supplied original PS2 game ISO at runtime.

	  https://github.com/open-goal/jak-project

comment "opengoal needs a glibc C++ toolchain, dynamic libs, wchar, threads, and an x86_64 build host"
	depends on (!BR2_aarch64 && !BR2_x86_64) || BR2_HOSTARCH != "x86_64" || \
		!BR2_TOOLCHAIN_USES_GLIBC || !BR2_INSTALL_LIBSTDCPP || BR2_STATIC_LIBS || \
		!BR2_TOOLCHAIN_HAS_THREADS || !BR2_USE_WCHAR || !BR2_USE_MMU || \
		!BR2_PACKAGE_PULSEAUDIO_HAS_ATOMIC
```

## package/batocera/utils/batocera-apps-aarch64/Config.in
```kconfig
config BR2_PACKAGE_BATOCERA_APPS_AARCH64
	bool "batocera apps aarch64"
	depends on BR2_aarch64
	depends on BR2_TOOLCHAIN_USES_GLIBC
	depends on BR2_PACKAGE_HAS_LIBGBM
	depends on BR2_PACKAGE_XORG7
	select BR2_PACKAGE_ALSA_LIB
	select BR2_PACKAGE_BROTLI
	select BR2_PACKAGE_CA_CERTIFICATES
	select BR2_PACKAGE_CUPS
	select BR2_PACKAGE_DBUS
	select BR2_PACKAGE_FONTCONFIG
	select BR2_PACKAGE_LIBCURL
	select BR2_PACKAGE_LIBERATION
	select BR2_PACKAGE_LIBGTK3
	select BR2_PACKAGE_LIBNSS
	select BR2_PACKAGE_LIBNSPR
	select BR2_PACKAGE_LIBXCB
	select BR2_PACKAGE_LIBXKBCOMMON
	select BR2_PACKAGE_P7ZIP
	select BR2_PACKAGE_QT6BASE
	select BR2_PACKAGE_QT6BASE_FONTCONFIG
	select BR2_PACKAGE_QT6BASE_GUI
	select BR2_PACKAGE_QT6BASE_GIF
	select BR2_PACKAGE_QT6BASE_JPEG
	select BR2_PACKAGE_QT6BASE_PNG
	select BR2_PACKAGE_QT6BASE_PRINTSUPPORT
	select BR2_PACKAGE_QT6BASE_WIDGETS
	select BR2_PACKAGE_QT6BASE_XCB if BR2_PACKAGE_XORG7
	select BR2_PACKAGE_VULKAN_LOADER
	select BR2_PACKAGE_WGET
	select BR2_PACKAGE_XLIB_LIBX11
	select BR2_PACKAGE_XLIB_LIBXCOMPOSITE
	select BR2_PACKAGE_XLIB_LIBXDAMAGE
	select BR2_PACKAGE_XLIB_LIBXEXT
	select BR2_PACKAGE_XLIB_LIBXFIXES
	select BR2_PACKAGE_XLIB_LIBXRANDR
	select BR2_PACKAGE_ZSTD
	select BR2_PACKAGE_FLATPAK
	help
	  Bundled aarch64 desktop applications exposed through the
	  EmulationStation "apps" system, including native Google Chrome
	  and Discord (Vesktop via Flatpak).

comment "batocera-apps-aarch64 needs a glibc aarch64 target with GBM"
	depends on !BR2_aarch64 || !BR2_TOOLCHAIN_USES_GLIBC || !BR2_PACKAGE_HAS_LIBGBM || \
		!BR2_PACKAGE_XORG7
```

## package/batocera/utils/batocera-arch-plasma-lxc/Config.in
```kconfig
config BR2_PACKAGE_BATOCERA_ARCH_PLASMA_LXC
	bool "batocera-arch-plasma-lxc"
	depends on BR2_aarch64
	depends on BR2_PACKAGE_BATOCERA_TARGET_QCS6490 || \
		   BR2_PACKAGE_BATOCERA_TARGET_SM8X50
	depends on BR2_PACKAGE_BATOCERA_DESKTOPAPPS
	depends on BR2_USE_MMU
	depends on BR2_TOOLCHAIN_HAS_THREADS
	depends on !BR2_STATIC_LIBS
	depends on BR2_TOOLCHAIN_GCC_AT_LEAST_4_7
	depends on BR2_TOOLCHAIN_HEADERS_AT_LEAST_3_0
	depends on !BR2_TOOLCHAIN_USES_UCLIBC
	select BR2_PACKAGE_BASH
	select BR2_PACKAGE_DIALOG
	select BR2_PACKAGE_DNSMASQ
	select BR2_PACKAGE_IPTABLES
	select BR2_PACKAGE_LXC
	select BR2_PACKAGE_XTERM
	help
	  Arch Linux KDE Plasma desktop launcher using LXC with direct KWin
	  DRM rendering. The LXC rootfs is created under /userdata on first
	  launch and is not packaged into the image.
```

## package/batocera/utils/batocera-install-internal/Config.in
```kconfig
config BR2_PACKAGE_BATOCERA_INSTALL_INTERNAL
	bool "batocera-install-internal"
	depends on BR2_PACKAGE_BATOCERA_TARGET_SM8550 || BR2_PACKAGE_BATOCERA_TARGET_SM8750
	depends on BR2_PACKAGE_XORG7
	default y
	select BR2_PACKAGE_BASH
	select BR2_PACKAGE_BATOCERA_ES_SYSTEM
	select BR2_PACKAGE_BATOCERA_SCRIPTS
	select BR2_PACKAGE_DIALOG
	select BR2_PACKAGE_DOSFSTOOLS
	select BR2_PACKAGE_DOSFSTOOLS_MKFS_FAT
	select BR2_PACKAGE_E2FSPROGS
	select BR2_PACKAGE_EVMAPY
	select BR2_PACKAGE_PARTED
	select BR2_PACKAGE_XTERM
	help
	  Add a gamepad-navigable EmulationStation tool that installs
	  Batocera beside Android on supported SM8550 and SM8750 handheld
	  internal storage using a ROCKNIX-compatible ABL.
```

## package/batocera/utils/batocera-steam-aarch64/Config.in
```kconfig
config BR2_PACKAGE_BATOCERA_STEAM_AARCH64
	bool "batocera-steam-aarch64"
	depends on BR2_aarch64
	depends on BR2_PACKAGE_BATOCERA_TARGET_SM8X50 || \
		   BR2_PACKAGE_BATOCERA_TARGET_SM8250 || \
		   BR2_PACKAGE_BATOCERA_TARGET_QCS6490
	select BR2_PACKAGE_BATOCERA_STEAM_REQUIREMENTS
	help
	  Steam launcher integration for Batocera aarch64 Qualcomm targets.
	  Launches the native ARM64 Steam beta client through steamrtarm64,
	  registers Proton 11.0 (ARM64) as a custom compatibility tool,
	  and intentionally avoids the old x86 Steam through FEX path.
```

## package/batocera/utils/batocera-steam/Config.in
```kconfig
config BR2_PACKAGE_BATOCERA_STEAM
	bool "batocera-steam"
	select BR2_PACKAGE_BATOCERA_STEAM_REQUIREMENTS

config BR2_PACKAGE_BATOCERA_STEAM_REQUIREMENTS
	bool "batocera-steam-requirements"

	# Core runtime
	select BR2_PACKAGE_LIBCURL
	select BR2_PACKAGE_DBUS
	select BR2_PACKAGE_DBUS_PYTHON
	select BR2_PACKAGE_GLIB2
	select BR2_PACKAGE_GNUTLS
	select BR2_PACKAGE_LIBXML2
	select BR2_PACKAGE_ZLIB
	select BR2_PACKAGE_BZIP2
	select BR2_PACKAGE_XZ

	# Audio/input
	select BR2_PACKAGE_ALSA_LIB
	select BR2_PACKAGE_ALSA_LIB_SEQ
	select BR2_PACKAGE_ALSA_LIB_RAWMIDI
	select BR2_PACKAGE_OPENAL
	select BR2_PACKAGE_SDL2

	# Fonts/rendering
	select BR2_PACKAGE_FONTCONFIG
	select BR2_PACKAGE_FREETYPE
	select BR2_PACKAGE_JPEG
	select BR2_PACKAGE_LIBPNG

	# Webhelper/UI requirements
	select BR2_PACKAGE_LIBNSS
	select BR2_PACKAGE_LIBGTK3 if BR2_PACKAGE_XORG7
	select BR2_PACKAGE_LIBGTK3_X11 if BR2_PACKAGE_XORG7
	select BR2_PACKAGE_PYTHON_GOBJECT

	# X11 runtime dependencies
	select BR2_PACKAGE_XORG7
	select BR2_PACKAGE_XLIB_LIBX11
	select BR2_PACKAGE_XLIB_LIBXCOMPOSITE
	select BR2_PACKAGE_XLIB_LIBXCURSOR
	select BR2_PACKAGE_XLIB_LIBXDAMAGE
	select BR2_PACKAGE_XLIB_LIBXEXT
	select BR2_PACKAGE_XLIB_LIBXFIXES
	select BR2_PACKAGE_XLIB_LIBXI
	select BR2_PACKAGE_XLIB_LIBXINERAMA
	select BR2_PACKAGE_XLIB_LIBXRANDR
	select BR2_PACKAGE_XLIB_LIBXRENDER
	select BR2_PACKAGE_XLIB_LIBXSCRNSAVER
	select BR2_PACKAGE_XLIB_LIBXTST
	select BR2_PACKAGE_XLIB_LIBXXF86VM
	select BR2_PACKAGE_LIBXCB
	select BR2_PACKAGE_LIBXKBCOMMON

	# Graphics/Vulkan host stack
	select BR2_PACKAGE_LIBDRM
	select BR2_PACKAGE_LIBGLVND
	select BR2_PACKAGE_MESA3D
	select BR2_PACKAGE_MESA3D_OPENGL_EGL
	select BR2_PACKAGE_MESA3D_OPENGL_ES
	select BR2_PACKAGE_MESA3D_OPENGL_GLX if BR2_PACKAGE_XORG7
	select BR2_PACKAGE_VULKAN_HEADERS
	select BR2_PACKAGE_VULKAN_LOADER
```

## package/batocera/utils/batocera-ubuntu-plasma-lxc/Config.in
```kconfig
config BR2_PACKAGE_BATOCERA_UBUNTU_PLASMA_LXC
	bool "batocera-ubuntu-plasma-lxc"
	depends on BR2_aarch64
	depends on BR2_PACKAGE_BATOCERA_TARGET_QCS6490 || \
		   BR2_PACKAGE_BATOCERA_TARGET_SM8X50
	depends on BR2_PACKAGE_BATOCERA_DESKTOPAPPS
	depends on BR2_USE_MMU
	depends on BR2_TOOLCHAIN_HAS_THREADS
	depends on !BR2_STATIC_LIBS
	depends on BR2_TOOLCHAIN_GCC_AT_LEAST_4_7
	depends on BR2_TOOLCHAIN_HEADERS_AT_LEAST_3_0
	depends on !BR2_TOOLCHAIN_USES_UCLIBC
	select BR2_PACKAGE_BASH
	select BR2_PACKAGE_DIALOG
	select BR2_PACKAGE_DNSMASQ
	select BR2_PACKAGE_IPTABLES
	select BR2_PACKAGE_LIBCURL
	select BR2_PACKAGE_LIBCURL_CURL
	select BR2_PACKAGE_LXC
	select BR2_PACKAGE_SQUASHFS
	select BR2_PACKAGE_XTERM
	help
	  Ubuntu 26.04 LTS KDE Plasma desktop launcher using LXC with direct
	  KWin DRM rendering. The arm64 rootfs is downloaded and extracted
	  under /userdata on first launch and is not packaged into the image.
```

## package/batocera/utils/clitools/Config.in
```kconfig
menu "CLI Power Tools"

config BR2_PACKAGE_CLITOOLS
	bool "CLI power tools bundle"
	help
	  Meta-package that enables a curated set of modern
	  CLI productivity, debugging, and system inspection tools.

	  This package installs no files itself.

	select BR2_PACKAGE_ZSH
	select BR2_PACKAGE_FISH
	select BR2_PACKAGE_GIT
    select BR2_PACKAGE_MAKE
	
	# Modern replacements
	select BR2_PACKAGE_EZA
	select BR2_PACKAGE_BAT

	# Monitoring / performance
	select BR2_PACKAGE_BTOP
	select BR2_PACKAGE_GLANCES
	select BR2_PACKAGE_BANDWHICH
	select BR2_PACKAGE_DUA
	select BR2_PACKAGE_DUF
	select BR2_PACKAGE_PROCS

	# Search / navigation
	select BR2_PACKAGE_FZF
	select BR2_PACKAGE_RIPGREP
	select BR2_PACKAGE_RIP
	select BR2_PACKAGE_SCC
	select BR2_PACKAGE_ZOXIDE
	select BR2_PACKAGE_SD

	# Utilities
	select BR2_PACKAGE_P7ZIP
	select BR2_PACKAGE_CUPS
	select BR2_PACKAGE_ARIA2
	select BR2_PACKAGE_LIBFUSE3
	select BR2_PACKAGE_HYPERFINE
	select BR2_PACKAGE_ICDIFF
	select BR2_PACKAGE_MICRO
	select BR2_PACKAGE_RANGER
	select BR2_PACKAGE_TREE
	select BR2_PACKAGE_TLDR
	select BR2_PACKAGE_TRE
	select BR2_PACKAGE_XMLSTARLET
	select BR2_PACKAGE_SCREENFETCH
	select BR2_PACKAGE_NEOFETCH
	select BR2_PACKAGE_SPEEDTEST_CLI


	# Debugging / introspection
	select BR2_PACKAGE_STRACE
	select BR2_PACKAGE_PAX_UTILS
	select BR2_PACKAGE_PKGCONF
	select BR2_PACKAGE_FILE
	select BR2_PACKAGE_LSOF
	select BR2_PACKAGE_PATCHELF
	select BR2_PACKAGE_JQ

	# QoL
	select BR2_PACKAGE_TMUX
	select BR2_PACKAGE_NCDU
	select BR2_PACKAGE_HTOP
	select BR2_PACKAGE_RSYNC
    select BR2_PACKAGE_LIBNSS
	select BR2_PACKAGE_LIBNSPR
	select BR2_PACKAGE_NODEJS
	select BR2_PACKAGE_NODEJS_NPM

	# Containers
	select BR2_PACKAGE_BATOCERA_DOCKER			if BR2_PACKAGE_HOST_GO_TARGET_ARCH_SUPPORTS && \
											   BR2_PACKAGE_HOST_GO_TARGET_CGO_LINKING_SUPPORTS && \
											   BR2_TOOLCHAIN_HAS_THREADS && \
											   !BR2_TOOLCHAIN_USES_UCLIBC && \
											   BR2_USE_MMU && \
											   BR2_PACKAGE_LIBSECCOMP_ARCH_SUPPORTS && \
											   BR2_TOOLCHAIN_HEADERS_AT_LEAST_3_17
	select BR2_PACKAGE_BATOCERA_DISTROBOX		if BR2_PACKAGE_HOST_GO_TARGET_ARCH_SUPPORTS && \
											   BR2_PACKAGE_HOST_GO_TARGET_CGO_LINKING_SUPPORTS && \
											   BR2_TOOLCHAIN_HAS_THREADS && \
											   !BR2_TOOLCHAIN_USES_UCLIBC && \
											   BR2_USE_MMU && \
											   BR2_PACKAGE_LIBSECCOMP_ARCH_SUPPORTS && \
											   BR2_TOOLCHAIN_HEADERS_AT_LEAST_3_17

endmenu
```

## package/batocera/utils/heroic/Config.in
```kconfig
config BR2_PACKAGE_HEROIC
	bool "heroic"
	depends on BR2_x86_64 || BR2_aarch64
	select BR2_PACKAGE_ALSA_LIB
	select BR2_PACKAGE_GDK_PIXBUF
	select BR2_PACKAGE_JPEG
	select BR2_PACKAGE_LIBGTK3
	select BR2_PACKAGE_LIBNSS
	select BR2_PACKAGE_LIBRSVG
	select BR2_PACKAGE_OPENAL
	help
	  Heroic Games Launcher packaged as an AppImage runtime wrapper
	  on x86_64 or as a native Electron runtime on aarch64.

comment "heroic needs an x86_64 or aarch64 target"
	depends on !BR2_x86_64 && !BR2_aarch64
```

## package/batocera/utils/lutris/Config.in
```kconfig
config BR2_PACKAGE_LUTRIS
	bool "lutris"
	#depends on BR2_x86_64
	# Baseline runtime coverage for native Linux Lutris titles.
	select BR2_PACKAGE_BATOCERA_STEAM_REQUIREMENTS
	select BR2_PACKAGE_SDL2_IMAGE
	select BR2_PACKAGE_SDL2_MIXER
	select BR2_PACKAGE_SDL2_TTF
	select BR2_PACKAGE_PULSEAUDIO
	select BR2_PACKAGE_OPENSSL
	select BR2_PACKAGE_OPENSSL_FORCE_LIBOPENSSL
	select BR2_PACKAGE_WEBP
	select BR2_PACKAGE_WEBP_DEMUX
	select BR2_PACKAGE_WEBP_MUX
	select BR2_PACKAGE_FAUDIO
	select BR2_PACKAGE_UTIL_LINUX_LIBUUID
	select BR2_PACKAGE_IRRLICHT			if BR2_PACKAGE_XORG7 && BR2_PACKAGE_HAS_LIBGL
	select BR2_PACKAGE_XAPP_XRANDR			if BR2_PACKAGE_XORG7
	select BR2_PACKAGE_MESA3D_DEMOS			if BR2_PACKAGE_XORG7 && BR2_PACKAGE_HAS_LIBGL
	# Native Lutris client stack.
	select BR2_PACKAGE_PYTHON3
	select BR2_PACKAGE_PYTHON3_XZ
	select BR2_PACKAGE_PYTHON_SETUPTOOLS
	select BR2_PACKAGE_PYTHON_PYCAIRO
	select BR2_PACKAGE_PYTHON_GOBJECT
	select BR2_PACKAGE_PYTHON_REQUESTS
	select BR2_PACKAGE_PYTHON_PILLOW
	select BR2_PACKAGE_PYTHON_PYYAML
	select BR2_PACKAGE_PYTHON_SETPROCTITLE
	select BR2_PACKAGE_PYTHON_DISTRO
	select BR2_PACKAGE_PYTHON_EVDEV
	select BR2_PACKAGE_PYTHON_LXML
	select BR2_PACKAGE_PYTHON_PROTOBUF
	select BR2_PACKAGE_DBUS
	select BR2_PACKAGE_DBUS_PYTHON
	select BR2_PACKAGE_GDK_PIXBUF
	select BR2_PACKAGE_JPEG
	select BR2_PACKAGE_LIBGTK3
	select BR2_PACKAGE_LIBRSVG
	select BR2_PACKAGE_FONT_AWESOME
	select BR2_PACKAGE_WEBKITGTK
	select BR2_PACKAGE_LUTRISVIEW
	help
	  Lutris built natively from source.
```

## package/batocera/utils/n64recomp-launcher/Config.in
```kconfig
config BR2_PACKAGE_N64RECOMP_LAUNCHER
	bool "n64recomp-launcher"
	depends on BR2_aarch64
	depends on BR2_TOOLCHAIN_USES_GLIBC
	depends on BR2_INSTALL_LIBSTDCPP
	depends on !BR2_STATIC_LIBS
	select BR2_PACKAGE_SDL2
	help
	  N64 Recomp Launcher packaged as a writable Batocera app.

	  The upstream launcher manages the dynamic recomp catalog, downloads,
	  ROM selection, settings, mods, and game updates. Batocera provides a
	  stable launcher entry and imports the launcher's generated desktop
	  shortcuts into EmulationStation.

comment "n64recomp-launcher needs an aarch64 glibc toolchain with libstdc++"
	depends on !BR2_aarch64 || !BR2_TOOLCHAIN_USES_GLIBC || !BR2_INSTALL_LIBSTDCPP || BR2_STATIC_LIBS
```

## package/batocera/utils/sunshine/Config.in
```kconfig
config BR2_PACKAGE_SUNSHINE
	bool "sunshine"
	depends on BR2_aarch64
	depends on BR2_INSTALL_LIBSTDCPP
	depends on BR2_TOOLCHAIN_HAS_THREADS_NPTL
	depends on BR2_USE_MMU
	depends on BR2_PACKAGE_HAS_LIBGBM
	select BR2_PACKAGE_BOOST
	select BR2_PACKAGE_BOOST_FILESYSTEM
	select BR2_PACKAGE_BOOST_LOCALE
	select BR2_PACKAGE_BOOST_LOG
	select BR2_PACKAGE_BOOST_PROGRAM_OPTIONS
	select BR2_PACKAGE_BOOST_SYSTEM
	select BR2_PACKAGE_FFMPEG
	select BR2_PACKAGE_FFMPEG_GPL
	select BR2_PACKAGE_FFMPEG_SWSCALE
	select BR2_PACKAGE_GLSLANG
	select BR2_PACKAGE_HOST_GLSLANG
	select BR2_PACKAGE_HOST_NODEJS
	select BR2_PACKAGE_JSON_FOR_MODERN_CPP
	select BR2_PACKAGE_LIBCAP
	select BR2_PACKAGE_LIBCURL
	select BR2_PACKAGE_LIBDRM
	select BR2_PACKAGE_LIBEVDEV
	select BR2_PACKAGE_LIBVA
	select BR2_PACKAGE_LIBMINIUPNPC
	select BR2_PACKAGE_NUMACTL
	select BR2_PACKAGE_OPENSSL
	select BR2_PACKAGE_OPUS
	select BR2_PACKAGE_PIPEWIRE
	select BR2_PACKAGE_PULSEAUDIO
	select BR2_PACKAGE_VULKAN_HEADERS
	select BR2_PACKAGE_VULKAN_LOADER
	select BR2_PACKAGE_WAYLAND
	select BR2_PACKAGE_WAYLAND_PROTOCOLS
	select BR2_PACKAGE_XDG_DESKTOP_PORTAL
	select BR2_PACKAGE_XDG_DESKTOP_PORTAL_WLR
	help
	  Sunshine game-streaming host built from source.

comment "sunshine needs an aarch64 target with C++, NPTL, MMU, and libgbm"
	depends on !BR2_aarch64 || !BR2_INSTALL_LIBSTDCPP || !BR2_TOOLCHAIN_HAS_THREADS_NPTL || !BR2_USE_MMU || !BR2_PACKAGE_HAS_LIBGBM
```
