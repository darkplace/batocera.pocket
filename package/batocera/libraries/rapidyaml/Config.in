## package/batocera/utils/waydroid/Config.in
```kconfig
config BR2_PACKAGE_WAYDROID
	bool "waydroid"
	depends on !BR2_PACKAGE_BATOCERA_TARGET_SM8750
	depends on BR2_PACKAGE_BATOCERA_WAYLAND
	depends on BR2_PACKAGE_PYTHON3
	depends on BR2_USE_MMU
	depends on BR2_TOOLCHAIN_HAS_THREADS
	select BR2_PACKAGE_DBUS
	select BR2_PACKAGE_DBUS_PYTHON
	select BR2_PACKAGE_PYTHON_GOBJECT
	select BR2_PACKAGE_PYTHON_GBINDER
	select BR2_PACKAGE_LXC
	select BR2_PACKAGE_IPTABLES
	select BR2_PACKAGE_DNSMASQ
	select BR2_PACKAGE_DIALOG
	select BR2_PACKAGE_SQLITE
	select BR2_PACKAGE_XTERM
	help
	  Waydroid Android container userspace.

	  https://github.com/waydroid/waydroid

comment "waydroid is unavailable on sm8750 and needs Batocera Wayland, python3, MMU and threads"
	depends on BR2_PACKAGE_BATOCERA_TARGET_SM8750 || !BR2_PACKAGE_BATOCERA_WAYLAND || !BR2_PACKAGE_PYTHON3 || !BR2_USE_MMU || !BR2_TOOLCHAIN_HAS_THREADS
```

## package/batocera/wine/dgvoodoo2/Config.in
```kconfig
config BR2_PACKAGE_DGVOODOO2
	bool "dgVoodoo2"
	help
	  dgVoodoo2 compatibility wrappers for legacy DirectX and Glide games.

	  https://github.com/dege-diosg/dgVoodoo2
```

## package/batocera/wine/umu-launcher/Config.in
```kconfig
config BR2_PACKAGE_UMU_LAUNCHER
	bool "umu-launcher"
	select BR2_PACKAGE_LIBCURL_CURL
	help
	  Unified Linux Wine Game Launcher.

	  https://github.com/Open-Wine-Components/umu-launcher
```

## package/batocera/wine/wine-ge-proton/Config.in
```kconfig
config BR2_PACKAGE_WINE_GE_PROTON
	bool "wine-ge-proton"

	help
	  Proton GE packaged as a built-in Batocera Wine runner.
	  This is primarily intended for use through umu-launcher.

	  https://github.com/GloriousEggroll/proton-ge-custom
```
