## package/batocera/utils/virt-manager/Config.in
```kconfig
config BR2_PACKAGE_VIRT_MANAGER
	bool "virt-manager"
	depends on !BR2_STATIC_LIBS
	depends on BR2_USE_MMU
	depends on BR2_USE_WCHAR
	depends on BR2_TOOLCHAIN_HAS_THREADS
	depends on BR2_PACKAGE_PYTHON3
	depends on BR2_PACKAGE_GOBJECT_INTROSPECTION_ARCH_SUPPORTS
	depends on BR2_TOOLCHAIN_USES_GLIBC
	depends on BR2_PACKAGE_ADWAITA_ICON_THEME
	depends on BR2_PACKAGE_GTK_VNC
	depends on BR2_PACKAGE_SPICE_GTK
	depends on BR2_PACKAGE_GOBJECT_INTROSPECTION
	depends on BR2_PACKAGE_GTKSOURCEVIEW
	depends on BR2_PACKAGE_HICOLOR_ICON_THEME
	depends on BR2_PACKAGE_LIBGTK3
	depends on BR2_PACKAGE_LIBGTK3_X11
	depends on BR2_PACKAGE_LIBOSINFO
	depends on BR2_PACKAGE_LIBVIRT_GLIB
	depends on BR2_PACKAGE_OSINFO_DB
	depends on BR2_PACKAGE_PYTHON_ARGCOMPLETE
	depends on BR2_PACKAGE_PYTHON_GOBJECT
	depends on BR2_PACKAGE_PYTHON_LIBXML2
	depends on BR2_PACKAGE_PYTHON_LIBVIRT
	depends on BR2_PACKAGE_PYTHON_REQUESTS
	depends on BR2_PACKAGE_SHARED_MIME_INFO
	depends on BR2_PACKAGE_VTE
	depends on BR2_PACKAGE_XORG7
	depends on BR2_PACKAGE_XORRISO
	help
	  Desktop tool for managing virtual machines via libvirt.

	  https://github.com/virt-manager/virt-manager

comment "virt-manager needs python3, Xorg, glibc, wchar, threads, dynamic library"
	depends on BR2_USE_MMU
	depends on BR2_PACKAGE_PYTHON3
	depends on BR2_PACKAGE_GOBJECT_INTROSPECTION_ARCH_SUPPORTS
	depends on !BR2_PACKAGE_XORG7 || BR2_STATIC_LIBS || !BR2_USE_WCHAR || !BR2_TOOLCHAIN_HAS_THREADS || !BR2_TOOLCHAIN_USES_GLIBC || \
		!BR2_PACKAGE_ADWAITA_ICON_THEME || !BR2_PACKAGE_GTK_VNC || !BR2_PACKAGE_SPICE_GTK || !BR2_PACKAGE_GOBJECT_INTROSPECTION || \
		!BR2_PACKAGE_GTKSOURCEVIEW || !BR2_PACKAGE_HICOLOR_ICON_THEME || !BR2_PACKAGE_LIBGTK3 || \
		!BR2_PACKAGE_LIBGTK3_X11 || !BR2_PACKAGE_LIBOSINFO || !BR2_PACKAGE_LIBVIRT_GLIB || \
		!BR2_PACKAGE_OSINFO_DB || !BR2_PACKAGE_PYTHON_ARGCOMPLETE || !BR2_PACKAGE_PYTHON_GOBJECT || \
		!BR2_PACKAGE_PYTHON_LIBXML2 || \
		!BR2_PACKAGE_PYTHON_LIBVIRT || !BR2_PACKAGE_PYTHON_REQUESTS || !BR2_PACKAGE_SHARED_MIME_INFO || \
		!BR2_PACKAGE_VTE || !BR2_PACKAGE_XORRISO
```
