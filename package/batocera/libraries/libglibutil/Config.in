## package/batocera/libraries/libglibutil/Config.in
```kconfig
config BR2_PACKAGE_LIBGLIBUTIL
	bool "libglibutil"
	select BR2_PACKAGE_LIBGLIB2
	help
	  Library of glib utilities used by Waydroid binder stack.

	  https://github.com/waydroid/libglibutil
```

## package/batocera/libraries/libosinfo/Config.in
```kconfig
config BR2_PACKAGE_LIBOSINFO
	bool "libosinfo"
	depends on !BR2_STATIC_LIBS
	depends on BR2_USE_MMU
	depends on BR2_USE_WCHAR
	depends on BR2_TOOLCHAIN_HAS_THREADS
	depends on BR2_PACKAGE_GOBJECT_INTROSPECTION_ARCH_SUPPORTS
	depends on BR2_TOOLCHAIN_USES_GLIBC
	select BR2_PACKAGE_GOBJECT_INTROSPECTION
	select BR2_PACKAGE_HWDATA
	select BR2_PACKAGE_HWDATA_PCI_IDS
	select BR2_PACKAGE_HWDATA_USB_IDS
	select BR2_PACKAGE_LIBGLIB2
	select BR2_PACKAGE_LIBSOUP3
	select BR2_PACKAGE_LIBSOUP3_SSL
	select BR2_PACKAGE_LIBXML2
	select BR2_PACKAGE_LIBXSLT
	help
	  Operating system metadata library used by virt-manager.

	  https://libosinfo.org/

comment "libosinfo needs a glibc toolchain, wchar, threads, dynamic library"
	depends on BR2_USE_MMU
	depends on BR2_PACKAGE_GOBJECT_INTROSPECTION_ARCH_SUPPORTS
	depends on BR2_STATIC_LIBS || !BR2_USE_WCHAR || !BR2_TOOLCHAIN_HAS_THREADS || !BR2_TOOLCHAIN_USES_GLIBC
```

## package/batocera/libraries/libpng12-compat/Config.in
```kconfig
config BR2_PACKAGE_LIBPNG12_COMPAT
	bool "libpng12-compat"
	depends on BR2_i386
	select BR2_PACKAGE_ZLIB
	help
	  Installs legacy libpng12 runtime compatibility library:
	  libpng12.so.0.
	  Intended for older prebuilt 32-bit binaries.
```

## package/batocera/libraries/libvirt-glib/Config.in
```kconfig
config BR2_PACKAGE_LIBVIRT_GLIB
	bool "libvirt-glib"
	depends on !BR2_STATIC_LIBS
	depends on BR2_USE_MMU
	depends on BR2_USE_WCHAR
	depends on BR2_TOOLCHAIN_HAS_THREADS
	depends on BR2_PACKAGE_GOBJECT_INTROSPECTION_ARCH_SUPPORTS
	depends on BR2_TOOLCHAIN_USES_GLIBC
	select BR2_PACKAGE_GOBJECT_INTROSPECTION
	select BR2_PACKAGE_LIBGLIB2
	select BR2_PACKAGE_LIBVIRT
	select BR2_PACKAGE_LIBXML2
	help
	  GObject wrappers and introspection bindings for libvirt.

	  https://libvirt.org/

comment "libvirt-glib needs a glibc toolchain, wchar, threads, dynamic library"
	depends on BR2_USE_MMU
	depends on BR2_PACKAGE_GOBJECT_INTROSPECTION_ARCH_SUPPORTS
	depends on BR2_STATIC_LIBS || !BR2_USE_WCHAR || !BR2_TOOLCHAIN_HAS_THREADS || !BR2_TOOLCHAIN_USES_GLIBC
```

## package/batocera/libraries/openssl102-compat/Config.in
```kconfig
config BR2_PACKAGE_OPENSSL102_COMPAT
	bool "openssl102-compat"
	depends on BR2_i386
	select BR2_PACKAGE_ZLIB
	help
	  Installs legacy OpenSSL 1.0 runtime compatibility libraries:
	  libssl.so.1.0.0 and libcrypto.so.1.0.0.
	  Intended for older prebuilt 32-bit binaries.
```

## package/batocera/libraries/osinfo-db/Config.in
```kconfig
config BR2_PACKAGE_OSINFO_DB
	bool "osinfo-db"
	help
	  Operating system metadata database for libosinfo.

	  https://libosinfo.org/
```

## package/batocera/libraries/python-gbinder/Config.in
```kconfig
config BR2_PACKAGE_PYTHON_GBINDER
	bool "python-gbinder"
	depends on !BR2_STATIC_LIBS
	depends on BR2_USE_WCHAR
	depends on BR2_TOOLCHAIN_HAS_THREADS
	depends on BR2_PACKAGE_PYTHON3
	select BR2_PACKAGE_HOST_PYTHON_CYTHON
	select BR2_PACKAGE_LIBGBINDER
	help
	  Python bindings for libgbinder used by Waydroid.

	  https://github.com/waydroid/gbinder-python

comment "python-gbinder needs a toolchain w/ wchar, threads, dynamic library"
	depends on BR2_PACKAGE_PYTHON3
	depends on BR2_STATIC_LIBS || !BR2_USE_WCHAR || !BR2_TOOLCHAIN_HAS_THREADS
```

## package/batocera/libraries/python-libvirt/Config.in
```kconfig
config BR2_PACKAGE_PYTHON_LIBVIRT
	bool "python-libvirt"
	depends on !BR2_STATIC_LIBS
	depends on BR2_USE_WCHAR
	depends on BR2_TOOLCHAIN_HAS_THREADS
	depends on BR2_PACKAGE_PYTHON3
	select BR2_PACKAGE_LIBVIRT
	help
	  Python bindings for libvirt.

	  https://libvirt.org/python.html

comment "python-libvirt needs python3, wchar, threads, dynamic library"
	depends on BR2_PACKAGE_PYTHON3
	depends on BR2_STATIC_LIBS || !BR2_USE_WCHAR || !BR2_TOOLCHAIN_HAS_THREADS
```

## package/batocera/libraries/python-libxml2/Config.in
```kconfig
config BR2_PACKAGE_PYTHON_LIBXML2
	bool "python-libxml2"
	depends on !BR2_STATIC_LIBS
	depends on BR2_USE_WCHAR
	depends on BR2_TOOLCHAIN_HAS_THREADS
	depends on BR2_PACKAGE_PYTHON3
	select BR2_PACKAGE_LIBXML2
	help
	  Python bindings for libxml2.

	  https://gitlab.gnome.org/GNOME/libxml2

comment "python-libxml2 needs python3, wchar, threads, dynamic library"
	depends on BR2_PACKAGE_PYTHON3
	depends on BR2_STATIC_LIBS || !BR2_USE_WCHAR || !BR2_TOOLCHAIN_HAS_THREADS
```

## package/batocera/libraries/spice-gtk/Config.in
```kconfig
config BR2_PACKAGE_SPICE_GTK
	bool "spice-gtk"
	depends on !BR2_STATIC_LIBS
	depends on BR2_USE_MMU
	depends on BR2_USE_WCHAR
	depends on BR2_TOOLCHAIN_HAS_THREADS
	depends on BR2_PACKAGE_GOBJECT_INTROSPECTION_ARCH_SUPPORTS
	depends on BR2_TOOLCHAIN_USES_GLIBC
	select BR2_PACKAGE_GOBJECT_INTROSPECTION
	select BR2_PACKAGE_GSTREAMER1
	select BR2_PACKAGE_GST1_PLUGINS_BASE
	select BR2_PACKAGE_JSON_GLIB
	select BR2_PACKAGE_JPEG
	select BR2_PACKAGE_LIBGTK3
	select BR2_PACKAGE_LIBGTK3_X11
	select BR2_PACKAGE_OPENSSL
	select BR2_PACKAGE_PIXMAN
	select BR2_PACKAGE_SPICE_PROTOCOL
	select BR2_PACKAGE_ZLIB
	help
	  spice-gtk client libraries and GI typelibs used by virt-manager
	  for SPICE graphical consoles.

	  https://www.spice-space.org/

comment "spice-gtk needs a glibc toolchain, wchar, threads, dynamic library"
	depends on BR2_USE_MMU
	depends on BR2_PACKAGE_GOBJECT_INTROSPECTION_ARCH_SUPPORTS
	depends on BR2_STATIC_LIBS || !BR2_USE_WCHAR || !BR2_TOOLCHAIN_HAS_THREADS || !BR2_TOOLCHAIN_USES_GLIBC
```

## package/batocera/ports/dusk/Config.in
```kconfig
config BR2_PACKAGE_DUSK
	bool "dusk"
	depends on BR2_aarch64 || BR2_x86_64
	depends on BR2_PACKAGE_HOST_RUSTC_TARGET_ARCH_SUPPORTS
	depends on BR2_TOOLCHAIN_HAS_THREADS
	depends on BR2_INSTALL_LIBSTDCPP
	depends on !BR2_STATIC_LIBS
	select BR2_PACKAGE_HOST_RUSTC
	select BR2_PACKAGE_BATOCERA_SDL3
	select BR2_PACKAGE_VULKAN_HEADERS
	select BR2_PACKAGE_VULKAN_LOADER
	select BR2_PACKAGE_LIBCURL
	select BR2_PACKAGE_FREETYPE
	select BR2_PACKAGE_ZLIB
	select BR2_PACKAGE_LIBPNG
	select BR2_PACKAGE_ALSA_LIB
	select BR2_PACKAGE_PULSEAUDIO
	select BR2_PACKAGE_DBUS
	select BR2_PACKAGE_UDEV
	help
	  Native Twilight Princess engine reimplementation.

	  Requires a user-supplied original game dump at runtime.

	  https://github.com/TwilitRealm/dusk

comment "dusk needs a dynamic C++ toolchain with threads and Rust target support"
	depends on !(BR2_aarch64 || BR2_x86_64) || BR2_STATIC_LIBS || \
		!BR2_TOOLCHAIN_HAS_THREADS || !BR2_INSTALL_LIBSTDCPP || \
		!BR2_PACKAGE_HOST_RUSTC_TARGET_ARCH_SUPPORTS
```

## package/batocera/utils/batocera-apps/Config.in
```kconfig
config BR2_PACKAGE_BATOCERA_APPS
	bool "batocera apps (AppImage bundle)"
	depends on BR2_x86_64
	help
	  Bundled AppImage desktop applications exposed through an
	  EmulationStation "apps" system.

comment "batocera-apps needs an x86_64 target"
	depends on !BR2_x86_64
```

## package/batocera/utils/batocera-distrobox/Config.in
```kconfig
config BR2_PACKAGE_BATOCERA_DISTROBOX
	bool "batocera distrobox"
	depends on BR2_PACKAGE_BATOCERA_DOCKER
	help
	  Distrobox shell tooling integrated with Docker.
	  This package installs the upstream distrobox scripts and a
	  minimal getent fallback for root-focused Batocera systems.

	  https://github.com/89luca89/distrobox

comment "batocera distrobox needs batocera docker stack"
	depends on !BR2_PACKAGE_BATOCERA_DOCKER
```

## package/batocera/utils/batocera-docker/Config.in
```kconfig
config BR2_PACKAGE_BATOCERA_DOCKER
	bool "batocera docker stack"
	depends on BR2_PACKAGE_HOST_GO_TARGET_ARCH_SUPPORTS
	depends on BR2_PACKAGE_HOST_GO_TARGET_CGO_LINKING_SUPPORTS
	depends on BR2_TOOLCHAIN_HAS_THREADS
	depends on !BR2_TOOLCHAIN_USES_UCLIBC
	depends on BR2_USE_MMU
	depends on BR2_PACKAGE_LIBSECCOMP_ARCH_SUPPORTS
	depends on BR2_TOOLCHAIN_HEADERS_AT_LEAST_3_17
	select BR2_PACKAGE_DOCKER_ENGINE
	select BR2_PACKAGE_DOCKER_ENGINE_DOCKER_INIT
	select BR2_PACKAGE_DOCKER_CLI
	select BR2_PACKAGE_DOCKER_CLI_BUILDX
	select BR2_PACKAGE_DOCKER_COMPOSE
	help
	  Enable Docker engine plus common Docker client tools:
	  docker-cli, buildx and docker-compose.

comment "batocera docker stack needs a glibc/musl toolchain with threads and headers >= 3.17"
	depends on BR2_PACKAGE_HOST_GO_TARGET_ARCH_SUPPORTS
	depends on BR2_PACKAGE_HOST_GO_TARGET_CGO_LINKING_SUPPORTS
	depends on BR2_USE_MMU
	depends on BR2_PACKAGE_LIBSECCOMP_ARCH_SUPPORTS
	depends on !BR2_TOOLCHAIN_HAS_THREADS || \
		BR2_TOOLCHAIN_USES_UCLIBC || \
		!BR2_TOOLCHAIN_HEADERS_AT_LEAST_3_17
```

## package/batocera/utils/box64/Config.in
```kconfig
config BR2_PACKAGE_BOX64
    bool "box64"

	select BR2_PACKAGE_ZSH
	select BR2_PACKAGE_FISH
	select BR2_PACKAGE_GIT

	# Modern replacements
	select BR2_PACKAGE_EZA
	select BR2_PACKAGE_BAT

	# Monitoring / performance
	select BR2_PACKAGE_BTOP
	select BR2_PACKAGE_GLANCES
	select BR2_PACKAGE_BANDWHICH
	select BR2_PACKAGE_DUA
	select BR2_PACKAGE_DUF
	select BR2_PACKAGE_PROCS

	# Search / navigation
	select BR2_PACKAGE_FZF
	select BR2_PACKAGE_RIPGREP
	select BR2_PACKAGE_RIP
	select BR2_PACKAGE_SCC
	select BR2_PACKAGE_ZOXIDE
	select BR2_PACKAGE_SD

	# Utilities
	select BR2_PACKAGE_P7ZIP
	select BR2_PACKAGE_CUPS
	select BR2_PACKAGE_ARIA2
	select BR2_PACKAGE_LIBFUSE3
	select BR2_PACKAGE_HYPERFINE
	select BR2_PACKAGE_ICDIFF
	select BR2_PACKAGE_MICRO
	select BR2_PACKAGE_TREE
	select BR2_PACKAGE_TLDR
	select BR2_PACKAGE_TRE
	select BR2_PACKAGE_XMLSTARLET
	select BR2_PACKAGE_SCREENFETCH
	select BR2_PACKAGE_NEOFETCH
	select BR2_PACKAGE_SPEEDTEST_CLI

	# Debugging / introspection
	select BR2_PACKAGE_STRACE
	select BR2_PACKAGE_PAX_UTILS
	select BR2_PACKAGE_PKGCONF
	select BR2_PACKAGE_FILE
	select BR2_PACKAGE_LSOF
	select BR2_PACKAGE_PATCHELF
	select BR2_PACKAGE_JQ

	# QoL
	select BR2_PACKAGE_TMUX
	select BR2_PACKAGE_NCDU
	select BR2_PACKAGE_HTOP
	select BR2_PACKAGE_RSYNC
	help
      Box64 is an x86_64 emulator for ARM64 platforms.

      It allows running x86_64 Linux binaries on ARM64 systems
      using dynamic recompilation.

      https://github.com/ptitseb/box64
```

## package/batocera/utils/box86/Config.in
```kconfig
config BR2_PACKAGE_BOX86
    bool "box86"
    depends on BR2_arm
    help
      Box86 is an i386 emulator for ARM platforms.

      It allows running i386 Linux binaries on ARM systems
      using dynamic recompilation.

      https://github.com/ptitseb/box86
```

## package/batocera/utils/gamescope/Config.in
```kconfig
config BR2_PACKAGE_GAMESCOPE
	bool "gamescope"
	# Needed so x11r7 symbols (xlib_*, xwayland) are defined in Kconfig.
	select BR2_PACKAGE_XORG7
	select BR2_PACKAGE_HWDATA
	select BR2_PACKAGE_LIBDECOR
	select BR2_PACKAGE_LIBDISPLAY_INFO
	select BR2_PACKAGE_XLIB_LIBX11
	select BR2_PACKAGE_LIBXCB
	select BR2_PACKAGE_XLIB_LIBXRES
	select BR2_PACKAGE_LUAJIT if !BR2_PACKAGE_LUA
	select BR2_PACKAGE_SEATD
	select BR2_PACKAGE_SEATD_DAEMON
	select BR2_PACKAGE_VULKAN_HEADERS
	select BR2_PACKAGE_VULKAN_LOADER
	select BR2_PACKAGE_WAYLAND
	select BR2_PACKAGE_WAYLAND_PROTOCOLS
	select BR2_PACKAGE_WLROOTS
	select BR2_PACKAGE_XLIB_LIBXMU
	select BR2_PACKAGE_XWAYLAND
	help
	  Gamescope micro-compositor used for SteamOS-like fullscreen sessions.

	  https://github.com/ValveSoftware/gamescope
```

## package/batocera/utils/libvirt-service/Config.in
```kconfig
config BR2_PACKAGE_LIBVIRT_SERVICE
    bool "libvirt-service"
    depends on BR2_PACKAGE_LIBVIRT_DAEMON
    help
      Batocera service wrapper for libvirt/virtlogd.
```

## package/batocera/utils/lutris-appimage/Config.in
```kconfig
config BR2_PACKAGE_LUTRIS_APPIMAGE
	bool "lutris-appimage (AppImage, legacy alternative)"
	depends on BR2_x86_64
	depends on !BR2_PACKAGE_LUTRIS
	# Baseline runtime coverage for native Linux Lutris titles.
	select BR2_PACKAGE_BATOCERA_STEAM_REQUIREMENTS
	select BR2_PACKAGE_SDL2_IMAGE
	select BR2_PACKAGE_SDL2_MIXER
	select BR2_PACKAGE_SDL2_TTF
	select BR2_PACKAGE_PULSEAUDIO
	select BR2_PACKAGE_OPENSSL
	select BR2_PACKAGE_OPENSSL_FORCE_LIBOPENSSL
	select BR2_PACKAGE_WEBP
	select BR2_PACKAGE_WEBP_DEMUX
	select BR2_PACKAGE_WEBP_MUX
	select BR2_PACKAGE_FAUDIO
	select BR2_PACKAGE_UTIL_LINUX_LIBUUID
	select BR2_PACKAGE_IRRLICHT			if BR2_PACKAGE_XORG7 && BR2_PACKAGE_HAS_LIBGL
	help
	  Lutris packaged as an AppImage runtime wrapper.
	  This is kept as an optional legacy alternative; native BR2_PACKAGE_LUTRIS
	  is the default path.

comment "lutris-appimage needs an x86_64 target"
	depends on !BR2_x86_64

comment "lutris-appimage conflicts with native lutris"
	depends on BR2_x86_64 && BR2_PACKAGE_LUTRIS
```

## package/batocera/utils/lutrisview/Config.in
```kconfig
config BR2_PACKAGE_LUTRISVIEW
	bool "lutrisview"
	depends on BR2_PACKAGE_LUTRIS || BR2_PACKAGE_LUTRIS_APPIMAGE
	select BR2_PACKAGE_PYTHON_PYGAME2
	help
	  Console-style fullscreen launcher frontend for Lutris.

	  https://github.com/redmie/lutrisview
```

## package/batocera/utils/nvtop/Config.in
```kconfig
config BR2_PACKAGE_NVTOP
	bool "nvtop"
	depends on BR2_PACKAGE_HAS_UDEV
	depends on !BR2_STATIC_LIBS
	depends on BR2_INSTALL_LIBSTDCPP
	select BR2_PACKAGE_LIBDRM
	select BR2_PACKAGE_NCURSES
	help
	  Interactive GPU process viewer for Linux.

	  https://github.com/Syllo/nvtop

comment "nvtop needs a toolchain w/ C++, dynamic library and udev"
	depends on !BR2_INSTALL_LIBSTDCPP || BR2_STATIC_LIBS || !BR2_PACKAGE_HAS_UDEV
```

## package/batocera/utils/squashfuse/Config.in
```kconfig
config BR2_PACKAGE_SQUASHFUSE
    bool "squashfuse"
    depends on BR2_PACKAGE_LIBFUSE3
    help
      Userspace SquashFS mounting tool using FUSE.
      Required by FEX-Emu for mounting rootfs images.
```

## package/batocera/utils/sunshine-appimage/Config.in
```kconfig
config BR2_PACKAGE_SUNSHINE_APPIMAGE
	bool "sunshine-appimage (AppImage)"
	depends on BR2_x86_64
	help
	  Sunshine game-streaming host packaged as an AppImage wrapper.

comment "sunshine-appimage needs an x86_64 target"
	depends on !BR2_x86_64
```

## package/batocera/utils/tailscale-service/Config.in
```kconfig
config BR2_PACKAGE_TAILSCALE_SERVICE
	bool "tailscale-service"
	depends on BR2_PACKAGE_HOST_GO_TARGET_ARCH_SUPPORTS
	depends on BR2_USE_MMU
	select BR2_PACKAGE_TAILSCALE
	help
	  Batocera service wrapper for tailscaled.
```
